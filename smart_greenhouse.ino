

```cpp
/*
  ======================================================================
  УМНАЯ ТЕПЛИЦА - ПОЛНАЯ ВЕРСИЯ С СИСТЕМОЙ ВОССТАНОВЛЕНИЯ ДИСПЛЕЯ
  ======================================================================
  
  ВСЕ ФУНКЦИИ И ФИШКИ СОХРАНЕНЫ:
  - Автоматическое восстановление дисплея (3 метода)
  - Фильтрация показаний датчиков
  - Гистерезис для фитоленты и форточки
  - Импульсное питание датчика воды (предотвращает электролиз)
  - Защита от зависания DHT11
  - Управление поливом, светом, вентиляцией
  - 5 экранов на дисплее
  - Отключение любых датчиков макросами
  - Настройка инвертированных реле и датчиков
*/

// =====================================================================
// РАЗДЕЛ 1: ПОДКЛЮЧЕНИЕ ВНЕШНИХ БИБЛИОТЕК
// =====================================================================

// Библиотека Wire - для работы с шиной I2C (медленная двунаправленная шина)
// I2C использует два провода: SDA (данные) и SCL (синхронизация)
// На Arduino Uno: SDA на пине A4, SCL на пине A5
// Подробнее: библиотека содержит функции begin(), beginTransmission(), endTransmission(), requestFrom()
#include <Wire.h>

// Библиотека для LCD дисплея с I2C интерфейсом
// Позволяет управлять дисплеем 16x2 всего по 2 проводам (вместо 6-8)
// Содержит функции: init(), clear(), setCursor(), print(), backlight(), noBacklight()
#include <LiquidCrystal_I2C.h>

// Библиотека для датчика температуры и влажности DHT11 (или DHT22)
// Содержит функции: begin(), readTemperature(), readHumidity()
// Внутри библиотеки реализована временная диаграмма опроса датчика (сигналы HIGH/LOW)
#include <DHT.h>

// Библиотека для управления сервоприводом (маленький мотор с обратной связью)
// Сервопривод получает сигнал ШИМ (PWM) - широтно-импульсную модуляцию
// Длительность импульса 1.5 мс = 0°, 1.5 мс = 90°, 2.5 мс = 180°
#include <Servo.h>

// БИБЛИОТЕКА ДЛЯ АППАРАТНОГО WATCHDOG (AVR)
// Watchdog — это встроенный в микроконтроллер таймер, который работает независимо от программы
// Если программа зависла и перестала его сбрасывать, watchdog через заданное время
// автоматически перезагружает микроконтроллер (Arduino перезапускается)
// Это называется "автоматическое восстановление после сбоя" (self-healing system)
// ПОДРОБНЕЕ: библиотека avr/wdt.h содержит функции wdt_enable(), wdt_reset(), wdt_disable()
#include <avr/wdt.h>


// =====================================================================
// РАЗДЕЛ 2: УМНАЯ СИСТЕМА ЗАЩИТЫ ДИСПЛЕЯ (УКАЗАТЕЛИ)
// =====================================================================

// LiquidCrystal_I2C* lcd = NULL - создаём УКАЗАТЕЛЬ на объект дисплея
// Указатель - это переменная, которая хранит адрес другого объекта в памяти
// NULL означает "ничего не указывает" - объект ещё не создан
// Это нужно для восстановления дисплея: мы можем удалить старый объект и создать новый
// Без указателя пришлось бы перезагружать всю плату Arduino
LiquidCrystal_I2C* lcd = NULL;

// uint8_t lcdAddress = 0 - переменная для хранения адреса дисплея на шине I2C
// uint8_t - беззнаковое 8-битное число (0-255)
// 0 означает "адрес ещё не найден"
// Адрес нужен чтобы обратиться именно к дисплею, а не к другому I2C-устройству
uint8_t lcdAddress = 0;

// const uint8_t POSSIBLE_LCD_ADDRESSES[] = {0x27, 0x3F} - массив возможных адресов дисплея
// const - константа, значение нельзя изменить
// uint8_t - тип элементов массива (0-255)
// [] - квадратные скобки означают "массив"
// {0x27, 0x3F} - инициализация массива значениями в шестнадцатеричной системе
// Большинство дисплеев имеют адрес 0x27 или 0x3F
const uint8_t POSSIBLE_LCD_ADDRESSES[] = {0x27, 0x3F};

// const int NUM_POSSIBLE_ADDRESSES = 2 - количество возможных адресов
// sizeof(POSSIBLE_LCD_ADDRESSES) / sizeof(POSSIBLE_LCD_ADDRESSES[0]) - вычислило бы 2 автоматически
// но для ясности пишем 2 (в массиве выше два адреса)
const int NUM_POSSIBLE_ADDRESSES = 2;


// =====================================================================
// РАЗДЕЛ 3: СИСТЕМА ВОССТАНОВЛЕНИЯ ДИСПЛЕЯ (enum и флаги)
// =====================================================================

// #define SUPER_PROTECTION true - определяем макрос для включения/выключения супер-защиты
// Макрос - текстовая замена перед компиляцией
// true = защита ВКЛЮЧЕНА, false = защита ВЫКЛЮЧЕНА
// #if SUPER_PROTECTION ... #else ... #endif - условная компиляция
#define SUPER_PROTECTION true

// enum DisplayMode - перечисление для состояний дисплея
// enum - пользовательский тип данных, который может принимать одно из перечисленных значений
// Внутри компилятор присваивает значения: DISPLAY_NORMAL = 0, DISPLAY_RECOVERING = 1, DISPLAY_DISCONNECTED = 2
// Это удобнее, чем использовать числа 0, 1, 2 - код становится самодокументируемым
enum DisplayMode {
  DISPLAY_NORMAL,      // Значение 0: дисплей работает нормально
  DISPLAY_RECOVERING,  // Значение 1: пытаемся восстановить дисплей
  DISPLAY_DISCONNECTED // Значение 2: дисплей отключен (сдались после 10 попыток)
};

// DisplayMode currentDisplayMode = DISPLAY_RECOVERING - создаём переменную для текущего состояния
// Изначально устанавливаем в DISPLAY_RECOVERING, потому что при запуске нужно сначала найти дисплей
// Это состояние означает "дисплей ещё не найден, пробуем восстановить"
DisplayMode currentDisplayMode = DISPLAY_RECOVERING;

// int displayRecoveryAttempts = 0 - счётчик попыток восстановления дисплея
// int - целое число (может быть отрицательным)
// Начальное значение = 0 (ещё не пытались)
int displayRecoveryAttempts = 0;

// const int MAX_RECOVERY_ATTEMPTS = 10 - максимальное количество попыток восстановления
// const - константа, значение нельзя изменить
// Если после 10 попыток не получилось - сдаёмся и переходим в DISPLAY_DISCONNECTED
const int MAX_RECOVERY_ATTEMPTS = 10;

// unsigned long lastRecoveryAttempt = 0 - время последней попытки восстановления
// unsigned long - 32-битное беззнаковое целое (0 до 4,294,967,295)
// Вмещает время до 49 дней в миллисекундах (millis())
// Используется для ограничения частоты попыток (не чаще 1 раза в 5 секунд)
unsigned long lastRecoveryAttempt = 0;

// const unsigned long RECOVERY_INTERVAL = 5000 - интервал между попытками восстановления
// 5000 миллисекунд = 5 секунд
// Не пытаемся восстанавливать слишком часто (это может вызвать дребезг)
const unsigned long RECOVERY_INTERVAL = 5000;

// unsigned long lastDisplaySuccess = 0 - время последней успешной работы дисплея
// Обновляется при каждой успешной операции с дисплеем (очистка, печать, установка курсора)
// Если 25 секунд не было успешных операций - инициируем восстановление
unsigned long lastDisplaySuccess = 0;

// bool forceDisplayReset = false - флаг для принудительного сброса дисплея
// bool - логический тип (true/false)
// true = нужно сделать принудительный сброс, false = не нужно
// Используется для внешнего принудительного восстановления (например, по команде с кнопки)
bool forceDisplayReset = false;


// =====================================================================
// РАЗДЕЛ 4: КОНФИГУРАЦИЯ ДАТЧИКОВ (ВКЛЮЧЕНИЕ/ОТКЛЮЧЕНИЕ МАКРОСАМИ)
// =====================================================================

// #define ENABLE_DHT true - макрос для включения/выключения датчика DHT11
// true = датчик подключен и работает
// false = датчик отключен (будут использоваться тестовые значения)
// Условная компиляция #if ENABLE_DHT ... #endif - код датчика не попадает в прошивку при false
#define ENABLE_DHT true

// #define ENABLE_SOIL true - макрос для включения/выключения датчика влажности почвы
// При false код опроса датчика не компилируется, soilMoistureFiltered = 50 (тестовое значение)
#define ENABLE_SOIL true

// #define ENABLE_LIGHT true - макрос для включения/выключения датчика освещённости (фоторезистор)
#define ENABLE_LIGHT true

// #define ENABLE_WATER false - макрос для включения/выключения датчика уровня воды
// СЕЙЧАС false - датчик отключен (waterPresent всегда true)
// Если подключите датчик воды, поставьте true
#define ENABLE_WATER true


// =====================================================================
// РАЗДЕЛ 5: ПОДКЛЮЧЕНИЕ УСТРОЙСТВ К ПИНАМ ARDUINO
// =====================================================================

// ----- ДАТЧИКИ (устройства ВВОДА - Arduino ЧИТАЕТ данные) -----

// #define DHT_PIN 2 - пин для подключения датчика DHT11
// DHT11 подключается к ЦИФРОВОМУ пину 2
// Цифровой пин может читать только HIGH (1) или LOW (0)
// Датчик передаёт данные последовательностью HIGH/LOW сигналов определённой длины
#define DHT_PIN 2

// #define DHTTYPE DHT11 - тип датчика (DHT11 или DHT22)
// DHT11 дешевле и медленнее (опрашивать раз в 2 секунды)
// DHT22 дороже, точнее и быстрее (опрашивать раз в 1 секунду)
#define DHTTYPE DHT11

// #define SOIL_MOISTURE_PIN A0 - пин для датчика влажности почвы
// Аналоговый пин A0 может измерять напряжение от 0 до 5В
// analogRead() возвращает 0-1023 (0В = 0, 5В = 1023)
#define SOIL_MOISTURE_PIN A0

// #define LIGHT_SENSOR_PIN A1 - пин для датчика освещённости (фоторезистор)
#define LIGHT_SENSOR_PIN A1

// #define WATER_SENSOR_PIN 6 - пин для сигнала датчика воды HCW-M203
// HCW-M203 - бинарный датчик (HIGH = вода есть, LOW = воды нет)
#define WATER_SENSOR_PIN 6

// #define WATER_SENSOR_RELAY_PIN 8 - пин для управления реле датчика воды
// Через это реле подаётся 12В на датчик воды
// Включаем питание только на 50 мс при измерении (импульсное питание)
// Это предотвращает электролиз медных проводов
#define WATER_SENSOR_RELAY_PIN 8

// ----- ИСПОЛНИТЕЛЬНЫЕ УСТРОЙСТВА (устройства ВЫВОДА - Arduino УПРАВЛЯЕТ) -----

// #define PUMP_PIN 3 - пин для управления насосом (через реле)
// Насос 12В, подключается через реле, реле управляется сигналом с Arduino
#define PUMP_PIN 3

// #define SERVO_PIN 4 - пин для управления сервоприводом (форточка)
// Сервопривод имеет 3 провода: питание (красный), земля (коричневый), сигнал (оранжевый)
#define SERVO_PIN 4

// #define LED_GROW_PIN 5 - пин для управления фитолентой (через реле)
// Фитолента 12В, подключается через реле
#define LED_GROW_PIN 5

// #define STATUS_LED 13 - пин для встроенного светодиода на плате Arduino
// Это физический светодиод рядом с пином 13 (можно увидеть на плате)
// Используется для визуальной индикации состояния системы
#define STATUS_LED 13


// =====================================================================
// РАЗДЕЛ 6: СОЗДАНИЕ ОБЪЕКТОВ ДЛЯ УПРАВЛЕНИЯ УСТРОЙСТВАМИ
// =====================================================================

// DHT dht(DHT_PIN, DHT11) - создаём объект для датчика DHT11
// Объект - это экземпляр класса, который содержит данные и методы для работы с датчиком
// Конструктор принимает номер пина и тип датчика
// После создания объекта можно вызывать методы: dht.begin(), dht.readTemperature(), dht.readHumidity()
DHT dht(DHT_PIN, DHT11);

// Servo ventServo - создаём объект для сервопривода с именем "ventServo"
// Пока не привязан к конкретному пину (привязка будет в setup() через ventServo.attach(SERVO_PIN))
Servo ventServo;


// =====================================================================
// РАЗДЕЛ 7: НАСТРОЙКИ СИСТЕМЫ (ПОРОГОВЫЕ ЗНАЧЕНИЯ И КАЛИБРОВКА)
// =====================================================================

// ----- ВРЕМЯ РАБОТЫ УСТРОЙСТВ (в миллисекундах) -----
// const unsigned long PUMP_RUN_TIME = 5000 - насос работает 5 секунд за один полив
// 5000 миллисекунд = 5 секунд
// Это время достаточно, чтобы почва пропиталась водой
const unsigned long PUMP_RUN_TIME = 2000;

// const unsigned long WATERING_COOLDOWN = 600000 - задержка между поливами
// 600000 мс = 600 секунд = 10 минут
// Даже если почва всё ещё сухая, насос не включится раньше чем через 10 минут
// Это предотвращает заливание растений и защищает насос от перегрева
const unsigned long WATERING_COOLDOWN = 600000;

// ----- ВЛАЖНОСТЬ ПОЧВЫ (в процентах) -----
// const int SOIL_DRY = 40 - порог СУХОЙ почвы (нужен полив)
// Если влажность < 40%, включаем полив
const int SOIL_DRY = 40;

// const int SOIL_WET = 70 - порог ВЛАЖНОЙ почвы (хватит поливать)
// Если влажность > 70%, выключаем полив
// Разница между SOIL_DRY и SOIL_WET (30%) - это ГИСТЕРЕЗИС
// Предотвращает частое включение/выключение насоса
const int SOIL_WET = 70;

// ----- ТЕМПЕРАТУРА ВОЗДУХА (в градусах Цельсия) -----
// const float OPEN_TEMP = 28.0 - температура ОТКРЫТИЯ форточки
// float - число с плавающей точкой (дробное)
// Если температура > 28.0°C, открываем форточку
const float OPEN_TEMP = 28.0;

// const float CLOSE_TEMP = 26.0 - температура ЗАКРЫТИЯ форточки
// Если температура < 26.0°C, закрываем форточку
// Разница 2 градуса - гистерезис, предотвращает дребезг форточки
const float CLOSE_TEMP = 26.0;

// ---------------------------------------------------------------------
// 4. ОСВЕЩЁННОСТЬ (в процентах)
// ---------------------------------------------------------------------
// ВНИМАНИЕ: Ваш датчик освещённости (фоторезистор) работает ИНВЕРТИРОВАННО:
//   - В ТЕМНОТЕ (рукой накрыли) → analogRead() возвращает БОЛЬШОЕ число (около 675) → 0%
//   - НА СВЕТУ (фонарик) → analogRead() возвращает МАЛЕНЬКОЕ число (около 0) → 100%
//
// Поэтому пороги срабатывания НАОБОРОТ по сравнению со стандартной логикой:
//   - Включаем фитоленту, когда освещённость ВЫСОКАЯ (>80%) — это означает, что на самом деле ТЕМНО
//   - Выключаем фитоленту, когда освещённость НИЗКАЯ (<20%) — это означает, что на самом деле СВЕТЛО
// =====================================================================

// const int DARK_THRESHOLD = 80 - порог ВКЛЮЧЕНИЯ фитоленты (когда на датчике "темно")
// Если освещённость > 80% (датчик показывает высокий процент), значит в реальности ТЕМНО → включаем фитоленту
const int DARK_THRESHOLD = 80;

// const int LIGHT_THRESHOLD = 20 - порог ВЫКЛЮЧЕНИЯ фитоленты (когда на датчике "светло")
// Если освещённость < 20% (датчик показывает низкий процент), значит в реальности СВЕТЛО → выключаем фитоленту
const int LIGHT_THRESHOLD = 20;

// Разница между DARK_THRESHOLD (80%) и LIGHT_THRESHOLD (20%) = 60% - это ГИСТЕРЕЗИС
// Предотвращает частое включение/выключение фитоленты при колебаниях освещённости
// Физический смысл:
//   - Фитолента включается, когда реальная освещённость падает ниже ~20% (темно)
//   - Фитолента выключается, когда реальная освещённость поднимается выше ~80% (светло)
//   - В промежутке от 20% до 80% состояние лампы НЕ МЕНЯЕТСЯ

// ----- НАСТРОЙКИ УГЛОВ СЕРВОПРИВОДА (в градусах) -----
// const int SERVO_CLOSED = 0 - угол ЗАКРЫТОЙ форточки
// 0° = форточка полностью закрыта
const int SERVO_CLOSED = 0;

// const int SERVO_OPEN = 90 - угол ОТКРЫТОЙ форточки
// 90° = форточка полностью открыта
// Если ваша форточка открывается на 120°, увеличьте это значение
const int SERVO_OPEN = 90;

// ----- НАСТРОЙКА ТИПА РЕЛЕ (LOW включает или HIGH включает) -----
// const bool RELAY_INVERTED = true - реле ИНВЕРТИРОВАННОЕ
// Большинство релейных модулей для Arduino сделаны так:
//   - LOW (0В) на пине → реле ВКЛЮЧАЕТСЯ (замыкает контакты COM и NO)
//   - HIGH (5В) на пине → реле ВЫКЛЮЧАЕТСЯ (размыкает контакты)
// Поэтому RELAY_INVERTED = true
const bool RELAY_INVERTED = false;

// ----- КАЛИБРОВКА ДАТЧИКА ВЛАЖНОСТИ ПОЧВЫ -----
// const int SOIL_DRY_CALIB = 554 - значение датчика в СУХОЙ почве
// Это число вы получили экспериментом (сухая земля → analogRead() = 554)
// Соответствует 0% влажности
const int SOIL_DRY_CALIB = 554;

// const int SOIL_WET_CALIB = 233 - значение датчика в МОКРОЙ почве
// Соответствует 100% влажности
const int SOIL_WET_CALIB = 233;

// ----- КАЛИБРОВКА ДАТЧИКА ОСВЕЩЁННОСТИ -----
// const int DARK_VALUE = 0 - значение в полной темноте
// Фоторезистор имеет максимальное сопротивление → напряжение близко к 0
const int DARK_VALUE = 0;

// const int BRIGHT_VALUE = 675 - значение при ярком свете
// Измерено вами (фонарик на датчик → analogRead() = 675)
const int BRIGHT_VALUE = 675;

// ----- НАСТРОЙКА БИНАРНОГО ДАТЧИКА ВОДЫ HCW-M203 -----
// const bool WATER_SENSOR_INVERTED = true - настройка инверсии
// Ваш датчик HCW-M203 выдаёт:
//   - HIGH (1) когда датчик в воде
//   - LOW (0) когда датчик в воздухе
// Поэтому WATER_SENSOR_INVERTED = true (HIGH = вода есть)
// Если датчик работает наоборот, поменяйте на false
const bool WATER_SENSOR_INVERTED = true;

// ----- НАСТРОЙКИ БЕЗОПАСНОСТИ НАСОСА -----
// const unsigned long MAX_PUMP_RUN_TIME = 30000 - максимальное время работы насоса
// 30000 миллисекунд = 30 секунд
const unsigned long MAX_PUMP_RUN_TIME = 30000;

// const unsigned long MIN_PUMP_OFF_TIME = 60000 - минимальное время простоя насоса
// 60000 миллисекунд = 60 секунд = 1 минута
const unsigned long MIN_PUMP_OFF_TIME = 60000;   // ← ТОЛЬКО ОДИН РАЗ!

// =====================================================================
// РАЗДЕЛ 8: ПЕРЕМЕННЫЕ ДЛЯ ХРАНЕНИЯ ДАННЫХ
// =====================================================================

// ----- ОТФИЛЬТРОВАННЫЕ ЗНАЧЕНИЯ ДАТЧИКОВ -----
// float tempFiltered = 25.0 - отфильтрованная температура
// float - число с плавающей точкой (нужна для точности)
// Начальное значение 25.0°C (комнатная температура)
// Хранит текущую температуру после сглаживания фильтром
float tempFiltered = 25.0;

// float humidityFiltered = 60.0 - отфильтрованная влажность воздуха
// Начальное значение 60.0% (нормальная влажность)
float humidityFiltered = 60.0;

// int soilMoistureFiltered = 50 - отфильтрованная влажность почвы
// int - целое число (проценты, дробная часть не нужна)
// Начальное значение 50% (средняя влажность)
int soilMoistureFiltered = 50;

// int lightLevelFiltered = 50 - отфильтрованная освещённость
// Начальное значение 50% (средняя освещённость)
int lightLevelFiltered = 50;

// ----- УРОВЕНЬ ВОДЫ В БАКЕ -----
// bool waterPresent = true - есть ли вода в баке
// true = вода ЕСТЬ, false = воды НЕТ
// Начальное значение true (считаем что вода есть, пока датчик не скажет иначе)
bool waterPresent = true;

// ----- КОЭФФИЦИЕНТ ФИЛЬТРАЦИИ (экспоненциальное сглаживание) -----
// const float FILTER_COEFF = 0.3 - коэффициент фильтрации (30%)
// Используется в applyFilter(): новое = старое * (1-коэфф) + сырое * коэфф
// 0.3 = 30% нового значения + 70% старого значения
// Убирает резкие скачки в показаниях (шум датчика)
const float FILTER_COEFF = 0.3;

// ----- СОСТОЯНИЯ ИСПОЛНИТЕЛЬНЫХ УСТРОЙСТВ -----
// bool pumpState = false - состояние насоса
bool pumpState = false;

// bool lampState = false - состояние фитоленты
bool lampState = false;

// bool windowIsOpen = false - состояние форточки (открыта/закрыта)
bool windowIsOpen = false;

// int ventAngle = 0 - текущий угол сервопривода (0-90°)
int ventAngle = 0;

// ----- ВРЕМЕННЫЕ ПЕРЕМЕННЫЕ (для контроля времени) -----
// unsigned long lastWatering = 0 - время последнего полива
unsigned long lastWatering = 0;

// unsigned long pumpStartTime = 0 - время включения насоса (для контроля длительности)
unsigned long pumpStartTime = 0;

// ----- УПРАВЛЕНИЕ ДИСПЛЕЕМ -----
// int displayScreen = 0 - номер текущего экрана (0,1,2,3,4)
int displayScreen = 0;

// const int MAX_DISPLAY_SCREENS = 5 - всего 5 экранов
const int MAX_DISPLAY_SCREENS = 5;

// unsigned long lastDisplayChange = 0 - время последней смены экрана
unsigned long lastDisplayChange = 0;

// const int DISPLAY_CHANGE_TIME = 3000 - менять экран каждые 3 секунды
const int DISPLAY_CHANGE_TIME = 3000;

// ----- СЧЁТЧИК ОШИБОК ДАТЧИКА DHT -----
// int dhtErrorCount = 0 - сколько ошибок подряд вернул датчик DHT
int dhtErrorCount = 0;

// const int MAX_DHT_ERRORS = 10 - максимальное количество ошибок подряд
// Если больше 10 ошибок подряд, датчик считаем сломанным
const int MAX_DHT_ERRORS = 10;


// =====================================================================
// РАЗДЕЛ 9: ФУНКЦИИ ДЛЯ АВТОМАТИЧЕСКОГО ВОССТАНОВЛЕНИЯ ДИСПЛЕЯ
// =====================================================================

// ФУНКЦИЯ 1: ПОИСК ДИСПЛЕЯ НА ШИНЕ I2C
// Назначение: найти дисплей на шине I2C по известным адресам (0x27, 0x3F)
// Алгоритм: перебирает все адреса из массива POSSIBLE_LCD_ADDRESSES
// Для каждого адреса пробует установить соединение через Wire.beginTransmission()
// Если устройство ответило (error == 0) - дисплей найден
// Возвращает: true если дисплей найден, false если не найден
bool discoverLCD() {
  // Выводим сообщение в Serial монитор о начале поиска
  Serial.println("Поиск дисплея на шине I2C...");
  
  // Цикл for для перебора всех возможных адресов дисплея
  // i = счётчик цикла, начинается с 0, увеличивается на 1 каждый раз
  // i < NUM_POSSIBLE_ADDRESSES (2) - цикл выполнится 2 раза: для i=0 и i=1
  for (int i = 0; i < NUM_POSSIBLE_ADDRESSES; i++) {
    
    // Берем очередной адрес из массива POSSIBLE_LCD_ADDRESSES
    // POSSIBLE_LCD_ADDRESSES[0] = 0x27, POSSIBLE_LCD_ADDRESSES[1] = 0x3F
    uint8_t address = POSSIBLE_LCD_ADDRESSES[i];
    
    // Выводим информацию о проверяемом адресе в Serial монитор
    Serial.print("Пробую адрес 0x");
    Serial.print(address, HEX);  // HEX - выводим в шестнадцатеричном формате
    Serial.print("... ");
    
    // Wire.beginTransmission(address) - начинаем передачу на указанный адрес
    // I2C шина: мастер (Arduino) обращается к ведомому с адресом address
    Wire.beginTransmission(address);
    
    // Wire.endTransmission() - завершаем передачу и получаем код ошибки
    // error = 0: успешно (устройство ответило)
    // error = 1: данные слишком длинные для буфера
    // error = 2: адрес не получен (NACK на адресе)
    // error = 3: данные не получены (NACK на данных)
    // error = 4: другая ошибка
    byte error = Wire.endTransmission();
    
    // Проверяем, есть ли ошибка (error == 0 значит успех)
    if (error == 0) {
      // Если ошибки нет (код 0) - дисплей найден!
      Serial.println("НАШЕЛ!");
      
      // Сохраняем найденный адрес в переменную lcdAddress
      lcdAddress = address;
      
      // Возвращаем true (успех) из функции
      return true;
      
    } else {
      // Если есть ошибка - на этом адресе никого нет
      Serial.println("нет ответа");
    }
    
    // Делаем короткую паузу 10 мс между попытками, чтобы не перегружать шину I2C
    delay(10);
  }
  
  // Если дошли до этой точки - ни на одном адресе не нашли дисплей
  Serial.println("Дисплей не найден на шине I2C");
  
  // Возвращаем false (неудача) из функции
  return false;
}

// ФУНКЦИЯ 2: ИНИЦИАЛИЗАЦИЯ ДИСПЛЕЯ
// Назначение: создать и настроить объект дисплея
// Шаги:
//   1. Если объект уже существует - удалить его (освободить память)
//   2. Найти дисплей на шине I2C (вызов discoverLCD)
//   3. Создать новый объект дисплея с найденным адресом
//   4. Инициализировать дисплей (lcd->init())
//   5. Включить подсветку (lcd->backlight())
//   6. Показать тестовое сообщение
// Возвращает: true если инициализация успешна, false если нет
bool initializeLCD() {
  // ШАГ 1: Проверяем, существует ли уже объект дисплея
  // lcd != NULL - указатель не равен NULL (то есть указывает на существующий объект)
  if (lcd != NULL) {
    // Если объект существует (указатель не равен NULL)
    // Удаляем старый объект из памяти с помощью оператора delete
    // delete освобождает память, выделенную оператором new
    delete lcd;
    
    // Устанавливаем указатель в NULL (теперь он ничего не указывает)
    lcd = NULL;
    
    // Ждем 100 мс чтобы память полностью освободилась
    delay(100);
  }
  
  // ШАГ 2: Пытаемся найти дисплей на шине I2C
  // !discoverLCD() означает "НЕ discoverLCD()" (true если discoverLCD вернул false)
  if (!discoverLCD()) {
    // Если не нашли дисплей (!discoverLCD() = true)
    // Возвращаем false - инициализация не удалась
    return false;
  }
  
  // ШАГ 3: Создаем новый объект дисплея
  // Оператор new выделяет память и создает объект класса LiquidCrystal_I2C
  // Параметры конструктора: адрес дисплея (lcdAddress), 16 столбцов, 2 строки
  lcd = new LiquidCrystal_I2C(lcdAddress, 16, 2);
  
  // ШАГ 4: Настраиваем дисплей
  // lcd->init() - вызываем метод init() у объекта дисплея для инициализации
  // Стрелка -> используется потому что lcd - это указатель, а не сам объект
  lcd->init();
  
  // Ждем 100 мс пока дисплей инициализируется (нужно для стабильности)
  delay(100);
  
  // Включаем подсветку дисплея с помощью метода backlight()
  lcd->backlight();
  
  // Ждем 50 мс после включения подсветки
  delay(50);
  
  // ШАГ 5: Показываем тестовое сообщение
  // Очищаем экран дисплея с помощью метода clear()
  lcd->clear();
  
  // Устанавливаем курсор в позицию: столбец 0, строка 0
  // setCursor(колонка, строка) - колонка от 0 до 15, строка от 0 до 1
  lcd->setCursor(0, 0);
  
  // Печатаем текст "LCD Found!" (только английские буквы!)
  // Русские буквы не поддерживаются в большинстве LCD дисплеев
  lcd->print("LCD Found!");
  
  // Переходим на вторую строку: столбец 0, строка 1
  lcd->setCursor(0, 1);
  
  // Печатаем текст "Addr: 0x"
  lcd->print("Addr: 0x");
  
  // Печатаем адрес дисплея в шестнадцатеричном формате
  lcd->print(lcdAddress, HEX);
  
  // Показываем сообщение 1 секунду (1000 мс)
  delay(1000);
  
  // Выводим информацию в Serial монитор
  Serial.print("Дисплей инициализирован на адресе 0x");
  Serial.println(lcdAddress, HEX);
  
  // Возвращаем true - инициализация успешна
  return true;
}

// ФУНКЦИЯ 3: ПРОВЕРКА ЗДОРОВЬЯ ДИСПЛЕЯ
// Назначение: проверить, отвечает ли дисплей на команды
// Метод проверки: выключаем и включаем отображение (не подсветку)
// Если дисплей завис, эти команды могут не выполниться
// Возвращает: true если дисплей здоров, false если нет
bool checkLCDHealth() {
  // Проверяем, существует ли объект дисплея (указатель не равен NULL)
  if (lcd == NULL) {
    // Если объекта нет - возвращаем false (дисплей не инициализирован)
    return false;
  }
  
  // Проверяем, включена ли супер-защита (макрос SUPER_PROTECTION)
  #if SUPER_PROTECTION
  // Если супер-защита включена (SUPER_PROTECTION = true)
  
  // Пытаемся выполнить простую операцию с дисплеем
  // lcd->noDisplay() - выключаем отображение (текст пропадает, но подсветка остаётся)
  lcd->noDisplay();
  
  // Ждем 10 мс
  delay(10);
  
  // lcd->display() - включаем отображение обратно
  lcd->display();
  
  // Ждем 10 мс
  delay(10);
  
  // Если выполнение дошло до этой точки без зависания - дисплей работает
  // Обновляем время последней успешной работы
  lastDisplaySuccess = millis();
  
  // Возвращаем true - дисплей здоров
  return true;
  
  #else
  // Если защита отключена (SUPER_PROTECTION = false)
  // Всегда считаем что дисплей работает (упрощённый режим)
  return true;
  #endif
}

// ФУНКЦИЯ 4: БЕЗОПАСНАЯ ПЕЧАТЬ НА ДИСПЛЕЙ
// Назначение: напечатать текст на дисплее безопасным способом
// Проверяет, что:
//   1. Объект дисплея существует (lcd != NULL)
//   2. Дисплей в нормальном режиме (currentDisplayMode == DISPLAY_NORMAL)
// Параметры:
//   text - текст для печати (только английский!)
//   col - столбец (0-15)
//   row - строка (0-1)
// Возвращает: true если печать успешна, false если нет
bool safePrint(const char* text, uint8_t col, uint8_t row) {
  // ПРОВЕРКА 1: Существует ли объект дисплея?
  if (lcd == NULL) {
    // Нет объекта - не можем печатать, возвращаем false
    return false;
  }
  
  // ПРОВЕРКА 2: Дисплей в нормальном режиме?
  if (currentDisplayMode != DISPLAY_NORMAL) {
    // Дисплей не в нормальном режиме - не печатаем, возвращаем false
    return false;
  }
  
  // Проверяем, включена ли супер-защита
  #if SUPER_PROTECTION
  // Если супер-защита включена
  
  // Устанавливаем курсор в указанную позицию
  lcd->setCursor(col, row);
  
  // Печатаем текст
  lcd->print(text);
  
  // Обновляем время последней успешной работы
  lastDisplaySuccess = millis();
  
  // Возвращаем true - успешно напечатали
  return true;
  
  #else
  // Если защита отключена - печатаем без проверок
  lcd->setCursor(col, row);
  lcd->print(text);
  return true;
  #endif
}

// ФУНКЦИЯ 5: ПОПЫТКА ВОССТАНОВЛЕНИЯ ДИСПЛЕЯ
// Назначение: попытаться восстановить работу дисплея после сбоя
// Использует 3 метода (по возрастанию сложности):
//   1. Мягкий сброс (выключить/включить подсветку)
//   2. Переинициализация (удалить объект и создать заново)
//   3. Полный сброс I2C шины (Wire.end() + Wire.begin())
// Возвращает: true если восстановление успешно, false если нет
bool attemptDisplayRecovery() {
  // Получаем текущее время в миллисекундах с помощью функции millis()
  unsigned long currentTime = millis();
  
  // Проверяем, можно ли пытаться восстановить сейчас
  // Если разница между текущим временем и временем последней попытки меньше RECOVERY_INTERVAL (5 сек)
  // - ещё рано пытаться (не спамим попытками)
  if (currentTime - lastRecoveryAttempt < RECOVERY_INTERVAL) {
    // Возвращаем false - ещё рано пытаться
    return false;
  }
  
  // Начинаем попытку восстановления
  Serial.println("Пытаюсь восстановить дисплей...");
  
  // Запоминаем время этой попытки
  lastRecoveryAttempt = currentTime;
  
  // Увеличиваем счетчик попыток на 1
  displayRecoveryAttempts++;
  
  // ===== МЕТОД 1: МЯГКИЙ СБРОС (самый простой) =====
  // Проверяем, существует ли объект дисплея
  if (lcd != NULL) {
    Serial.println("Метод 1: Мягкий сброс");
    
    // Выключаем подсветку дисплея (но сам дисплей остаётся включённым)
    lcd->noBacklight();
    
    // Ждем 200 мс
    delay(200);
    
    // Включаем подсветку обратно
    lcd->backlight();
    
    // Ждем 200 мс
    delay(200);
    
    // Проверяем, помогло ли (дисплей отвечает на команды?)
    if (checkLCDHealth()) {
      // Если помогло - вызываем функцию успешного восстановления
      recoverySuccess();
      
      // Возвращаем true - восстановление успешно
      return true;
    }
  }
  
  // ===== МЕТОД 2: ПЕРЕИНИЦИАЛИЗАЦИЯ (создаём объект заново) =====
  Serial.println("Метод 2: Переинициализация");
  
  // Пробуем создать дисплей заново с помощью функции initializeLCD()
  // initializeLCD() сама удалит старый объект и создаст новый
  if (initializeLCD()) {
    // Проверяем, работает ли теперь дисплей
    if (checkLCDHealth()) {
      // Если работает - вызываем функцию успешного восстановления
      recoverySuccess();
      
      // Возвращаем true - восстановление успешно
      return true;
    }
  }
  
  // ===== МЕТОД 3: ПОЛНЫЙ СБРОС I2C ШИНЫ =====
  // Делаем только после 3-х неудачных попыток (чтобы не сбрасывать шину слишком часто)
  if (displayRecoveryAttempts >= 3) {
    Serial.println("Метод 3: Полный сброс I2C шины");
    
    // Wire.end() - отключаем всю шину I2C
    // Освобождает пины SDA и SCL, останавливает I2C периферию
    Wire.end();
    
    // Ждем 100 мс
    delay(100);
    
    // Wire.begin() - включаем шину I2C заново
    // Инициализирует I2C периферию с частотой 100 кГц
    Wire.begin();
    
    // Ждем 100 мс
    delay(100);
    
    // Пробуем инициализировать дисплей после сброса шины
    // && означает "И" - оба условия должны быть true
    if (initializeLCD() && checkLCDHealth()) {
      // Если работает - вызываем функцию успешного восстановления
      recoverySuccess();
      
      // Возвращаем true - восстановление успешно
      return true;
    }
  }
  
  // Если сделали 10 попыток и все неудачные
  if (displayRecoveryAttempts >= MAX_RECOVERY_ATTEMPTS) {
    Serial.println("Слишком много неудачных попыток. Сдаюсь.");
    
    // Переходим в режим "отключен" - больше не пытаемся
    currentDisplayMode = DISPLAY_DISCONNECTED;
  }
  
  // Возвращаем false - восстановление не удалось
  return false;
}

// ФУНКЦИЯ 6: ОБРАБОТКА УСПЕШНОГО ВОССТАНОВЛЕНИЯ
// Назначение: выполнить действия после успешного восстановления дисплея
// Обнуляет счётчик попыток, переключает дисплей в нормальный режим,
// показывает сообщение о восстановлении на 1.5 секунды
void recoverySuccess() {
  // Выводим сообщение в Serial монитор
  Serial.println("Дисплей успешно восстановлен!");
  
  // Сбрасываем счетчик попыток восстановления в 0
  displayRecoveryAttempts = 0;
  
  // Переходим в нормальный режим
  currentDisplayMode = DISPLAY_NORMAL;
  
  // Обновляем время последней успешной работы
  lastDisplaySuccess = millis();
  
  // Возвращаемся к первому экрану (0)
  displayScreen = 0;
  
  // Сбрасываем таймер смены экрана (чтобы сразу не переключился)
  lastDisplayChange = millis();
  
  // Показываем сообщение о восстановлении на дисплее
  lcd->clear();
  lcd->setCursor(0, 0);
  lcd->print("Recovered!");     // "Восстановлено!"
  lcd->setCursor(0, 1);
  lcd->print("Resuming...");    // "Продолжаю..."
  
  // Показываем сообщение 1.5 секунды (1500 мс)
  delay(1500);
}


// =====================================================================
// РАЗДЕЛ 10: ВСПОМОГАТЕЛЬНЫЕ ФУНКЦИИ (ФИЛЬТРЫ, УСРЕДНЕНИЕ)
// =====================================================================

// ФУНКЦИЯ 7: ФИЛЬТР СГЛАЖИВАНИЯ ЗНАЧЕНИЙ (экспоненциальное сглаживание)
// Назначение: убирает резкие скачки в показаниях датчиков
// Применяется ко всем датчикам (температура, влажность, почва, свет)
// Формула: новое = старое * (1 - коэффициент) + новое_сырое * коэффициент
// При коэффициенте 0.3: 70% от старого значения + 30% от нового
// Пример: было 50, пришло 100 → результат = 50*0.7 + 100*0.3 = 35+30 = 65
// Параметры:
//   oldValue - предыдущее отфильтрованное значение (float)
//   newValue - новое "сырое" значение с датчика (float)
//   coeff - коэффициент фильтрации (0.0 - 1.0)
// Возвращает: новое отфильтрованное значение
float applyFilter(float oldValue, float newValue, float coeff) {
  // Формула экспоненциального сглаживания
  // oldValue * (1 - coeff) - берём (1-коэффициент)% от старого значения
  // newValue * coeff - берём коэффициент% от нового значения
  // Складываем и возвращаем результат
  return oldValue * (1 - coeff) + newValue * coeff;
}

// ФУНКЦИЯ 8: ТОЧНОЕ ИЗМЕРЕНИЕ ВЛАЖНОСТИ ПОЧВЫ (с усреднением)
// Назначение: получаем стабильные показания датчика почвы
// Проблема: датчик почвы даёт неточные значения из-за помех
// Решение: делаем 10 измерений, сортируем, исключаем выбросы, берём среднее
// Алгоритм:
//   1. Делаем 10 измерений и сохраняем в массив
//   2. Сортируем массив по возрастанию (пузырьковая сортировка)
//   3. Отбрасываем 2 самых маленьких и 2 самых больших (убираем выбросы)
//   4. Берём среднее арифметическое оставшихся 6 значений
// Возвращает: усреднённое "сырое" значение (0-1023)
int readSoilMoistureStable() {
  // Проверяем, включен ли датчик влажности почвы в настройках
  #if ENABLE_SOIL  // Если ENABLE_SOIL = true
  
  const int NUM_READINGS = 10;  // Количество измерений для усреднения
  int readings[NUM_READINGS];   // Массив для хранения измерений (10 элементов)
  
  // Цикл для сбора измерений с датчика
  // i = 0; i < NUM_READINGS; i++ - повторяем NUM_READINGS раз
  for (int i = 0; i < NUM_READINGS; i++) {
    // analogRead(SOIL_MOISTURE_PIN) - читаем значение с аналогового пина A0
    readings[i] = analogRead(SOIL_MOISTURE_PIN);
    delay(2);  // Короткая пауза 2 мс для стабилизации датчика
  }
  
  // СОРТИРОВКА измерений по возрастанию (пузырьковая сортировка)
  // Это нужно чтобы исключить выбросы (очень большие или очень маленькие значения)
  // Внешний цикл: проходим по всем элементам массива
  for (int i = 0; i < NUM_READINGS - 1; i++) {
    // Внутренний цикл: сравниваем текущий элемент со всеми следующими
    for (int j = i + 1; j < NUM_READINGS; j++) {
      // Если текущий элемент больше следующего (неправильный порядок)
      if (readings[i] > readings[j]) {
        // Меняем элементы местами
        int temp = readings[i];      // Сохраняем текущий элемент во временную переменную
        readings[i] = readings[j];   // Записываем на место текущего меньший элемент
        readings[j] = temp;          // Записываем на место следующего больший элемент
      }
    }
  }
  
  // Суммируем средние значения, исключая 2 самых маленьких и 2 самых больших
  // Это убирает возможные выбросы (ошибки измерений)
  int sum = 0;  // Переменная для хранения суммы
  // Начинаем с индекса 2 (третий элемент), заканчиваем NUM_READINGS-2 (предпоследний элемент)
  // Так пропускаем readings[0] и readings[1] (2 минимальных)
  // и readings[8] и readings[9] (2 максимальных)
  for (int i = 2; i < NUM_READINGS - 2; i++) {
    sum += readings[i];  // Добавляем значение к сумме
  }
  
  // Возвращаем среднее значение (сумма / количество)
  // NUM_READINGS - 4 = 10 - 4 = 6 (столько значений мы просуммировали)
  return sum / (NUM_READINGS - 4);
  
  #else  // Если ENABLE_SOIL = false (датчик отключен)
  
  // Возвращаем среднее значение 512 (середина диапазона 0-1023)
  // Это тестовое значение для проверки логики без датчика
  return 512;
  
  #endif
}

// ФУНКЦИЯ 9: ЧТЕНИЕ АНАЛОГОВОГО ДАТЧИКА С УСРЕДНЕНИЕМ
// Назначение: универсальная функция для любого аналогового датчика
// Применяется для датчика освещённости (фоторезистор)
// Параметр: pin - номер аналогового пина для чтения
// Возвращает: усреднённое значение (0-1023)
int readAnalogSensorStable(int pin) {
  const int NUM_READINGS = 10;  // Количество измерений
  int readings[NUM_READINGS];   // Массив для хранения
  
  // Собираем измерения с указанного пина
  for (int i = 0; i < NUM_READINGS; i++) {
    readings[i] = analogRead(pin);  // Читаем значение с указанного пина
    delay(2);  // Короткая пауза
  }
  
  // СОРТИРОВКА измерений по возрастанию (пузырьковая сортировка)
  for (int i = 0; i < NUM_READINGS - 1; i++) {
    for (int j = i + 1; j < NUM_READINGS; j++) {
      if (readings[i] > readings[j]) {
        int temp = readings[i];
        readings[i] = readings[j];
        readings[j] = temp;
      }
    }
  }
  
  // Суммируем средние значения (исключаем крайние - по 2 с каждого конца)
  int sum = 0;
  for (int i = 2; i < NUM_READINGS - 2; i++) {
    sum += readings[i];
  }
  
  // Возвращаем среднее арифметическое
  return sum / (NUM_READINGS - 4);
}


// =====================================================================
// РАЗДЕЛ 11: ФУНКЦИЯ НАЧАЛЬНОЙ НАСТРОЙКИ (SETUP)
// =====================================================================
// Функция setup() выполняется ОДИН РАЗ при включении или перезагрузке Arduino
// Здесь мы настраиваем:
//   - Watchdog (автоперезагрузка при зависании)
//   - Пины (какие работают на вход, какие на выход)
//   - Дисплей (поиск адреса, инициализация)
//   - Датчики (DHT11, датчик воды)
//   - Исполнительные устройства (насос, фитолента, сервопривод)
//   - Таймеры (переменные для отсчёта времени)
//
// ВАЖНО: RELAY_INVERTED = false (реле ОБЫЧНОЕ)
// Это означает: HIGH (5В) = ВКЛЮЧЕНО, LOW (0В) = ВЫКЛЮЧЕНО
// =====================================================================

void setup() {
  // Настраиваем светодиод для проверки
  pinMode(STATUS_LED, OUTPUT);
  digitalWrite(STATUS_LED, LOW);
  
  // Мигаем 5 раз быстро — сигнал, что Arduino запустился
  for (int i = 0; i < 5; i++) {
    digitalWrite(STATUS_LED, HIGH);
    delay(100);
    digitalWrite(STATUS_LED, LOW);
    delay(100);
  }

  // -------------------------------------------------------------------
  // БЛОК 0: ВКЛЮЧЕНИЕ WATCHDOG (САМЫЙ ПЕРВЫЙ, ДО ВСЕХ НАСТРОЕК!)
  // -------------------------------------------------------------------
  // Watchdog — это встроенный в микроконтроллер таймер, который работает независимо от программы.
  // Если программа зависла и перестала сбрасывать watchdog, через заданное время он автоматически
  // перезагружает Arduino. Это называется "самовосстановление системы".
  // Ставим watchdog в САМОМ НАЧАЛЕ, чтобы он защищал весь процесс инициализации.
  
  // wdt_enable(WDTO_2S) - включаем watchdog с таймаутом 2 секунды
  // Константа WDTO_2S определена в библиотеке avr/wdt.h
  // Значение 2 секунды означает: если программа не вызовет wdt_reset() в течение 2 секунд,
  // микроконтроллер принудительно перезагрузится
  // Другие варианты: WDTO_1S (1 сек), WDTO_4S (4 сек), WDTO_8S (8 сек)
  wdt_enable(WDTO_8S);
  
  // Serial.begin(9600) - открываем порт для отладки со скоростью 9600 бит/сек
  // Через USB-кабель можно смотреть сообщения на компьютере в мониторе порта
  Serial.begin(9600);
  
  // Выводим сообщение, что watchdog включён (полезно для отладки)
  Serial.println("Watchdog enabled (2 seconds timeout)");
  
  // Небольшая пауза 50 мс для стабилизации watchdog после включения
  // Некоторые версии Arduino требуют задержки после wdt_enable()
  delay(50);
  
  // wdt_reset() - сбрасываем таймер watchdog (говорим "я жив, всё работает")
  // Если этот вызов не произойдёт в течение 2 секунд, Arduino перезагрузится
  wdt_reset();


  // -------------------------------------------------------------------
  // БЛОК 1: НАСТРОЙКА ПИТАНИЯ НАСОСА (в самом начале, для безопасности)
  // -------------------------------------------------------------------
  // Сразу после включения Arduino все пины находятся в неопределённом состоянии
  // Могут быть как HIGH (5В), так и LOW (0В) — это зависит от предыдущего состояния
  // Поэтому мы принудительно устанавливаем насос в ВЫКЛЮЧЕННОЕ состояние,
  // чтобы он не начал работать случайно при старте программы
  
  pinMode(PUMP_PIN, OUTPUT);        // Настраиваем пин 3 как выход (можем подавать напряжение)
  digitalWrite(PUMP_PIN, LOW);      // LOW (0В) = ВЫКЛЮЧЕНО (при RELAY_INVERTED = false)
  wdt_reset();                      // Сбрасываем watchdog (важный шаг завершён)


  // -------------------------------------------------------------------
  // БЛОК 2: ДЛИННАЯ ПАУЗА ДЛЯ СТАБИЛИЗАЦИИ ПИТАНИЯ (разбиваем на части!)
  // -------------------------------------------------------------------
  // После подачи питания многие устройства (дисплей, датчики) требуют времени на "пробуждение"
  // Если начать работу с ними сразу — могут быть ошибки или зависания.
  // Нужно подождать 3 секунды, но delay(3000) вызовет срабатывание watchdog, потому что
  // 3 секунды больше таймаута (2 секунды). Функция delay() — это "пустой" цикл, внутри которого
  // watchdog не сбрасывается, поэтому через 2 секунды watchdog перезагрузит Arduino.
  // Решение: разбиваем 3 секунды на 30 коротких пауз по 100 мс, и после каждой сбрасываем watchdog.
  
  // Цикл for выполняется 30 раз: i = 0, 1, 2, ... 29
  // 30 × 100 мс = 3000 мс = 3 секунды
  for (int i = 0; i < 30; i++) {
    delay(100);                     // Короткая пауза 100 мс (безопасно для watchdog)
    wdt_reset();                    // Сбрасываем watchdog каждые 100 мс
  }
  
  
  // -------------------------------------------------------------------
  // БЛОК 3: НАСТРОЙКА ПОСЛЕДОВАТЕЛЬНОГО ПОРТА (USB-СВЯЗЬ С КОМПЬЮТЕРОМ)
  // -------------------------------------------------------------------
  // Выводим приветственное сообщение в Serial монитор компьютера
  // Это полезно для отладки и понимания, что происходит
  Serial.println("=== SMART GREENHOUSE STARTED ===");
  Serial.println("System initialization...");
  wdt_reset();                      // Сбрасываем watchdog


  // -------------------------------------------------------------------
  // БЛОК 4: НАСТРОЙКА ШИНЫ I2C (ДЛЯ СВЯЗИ С ДИСПЛЕЕМ)
  // -------------------------------------------------------------------
  // Wire.begin() - инициализирует библиотеку Wire для работы с шиной I2C
  // I2C нужен для связи с LCD дисплеем (всего 2 провода: SDA и SCL)
  // На Arduino Uno: SDA на пине A4, SCL на пине A5
  Wire.begin();                     // Запускаем шину I2C
  delay(100);                       // Ждём 100 мс для стабилизации шины
  wdt_reset();                      // Сбрасываем watchdog


  // -------------------------------------------------------------------
  // БЛОК 5: НАСТРОЙКА ВСТРОЕННОГО СВЕТОДИОДА (ДЛЯ ИНДИКАЦИИ)
  // -------------------------------------------------------------------
  // Встроенный светодиод на пине 13 — это физический светодиод на плате Arduino
  // Используем его для визуальной индикации работы системы
  
  pinMode(STATUS_LED, OUTPUT);      // Настраиваем пин 13 как выход
  digitalWrite(STATUS_LED, LOW);    // Выключаем светодиод (LOW = 0В = выключен)
  
  // Мигаем светодиодом 3 раза для проверки, что Arduino жив и работает
  // Цикл for выполняется 3 раза: i = 0, 1, 2
  for (int i = 0; i < 3; i++) {
    digitalWrite(STATUS_LED, HIGH); // Включаем светодиод (HIGH = 5В)
    delay(200);                     // Ждём 200 мс
    digitalWrite(STATUS_LED, LOW);  // Выключаем светодиод
    delay(200);                     // Ждём 200 мс
    wdt_reset();                    // Сбрасываем watchdog внутри цикла
  }
  wdt_reset();                      // Сбрасываем watchdog после цикла


    // -------------------------------------------------------------------
  // БЛОК 6: ПОИСК И НАСТРОЙКА LCD ДИСПЛЕЯ (ИСПРАВЛЕННАЯ ВЕРСИЯ)
  // -------------------------------------------------------------------
  // Это исправленная версия, которая работает стабильно и не зависает.
  // В отличие от старой версии, здесь:
  // 1. Нет сложных указателей и переопределений
  // 2. Есть защита от зависания через wdt_reset()
  // 3. Короткие задержки между операциями с дисплеем
  // 4. Понятный поиск адреса без лишних функций
  // =====================================================================
  
  // Выводим сообщение в Serial монитор о начале поиска дисплея
  Serial.println("\nИщу дисплей...");
  
  // Переменная для хранения найденного адреса дисплея
  // uint8_t - тип для хранения чисел от 0 до 255 (адрес I2C в диапазоне 0x00-0x7F)
  // foundAddress = 0 означает "адрес ещё не найден"
  uint8_t foundAddress = 0;
  
  // ---------- ШАГ 1: ПОИСК ДИСПЛЕЯ НА ШИНЕ I2C ----------
  // Цикл for перебирает все возможные адреса из массива POSSIBLE_LCD_ADDRESSES
  // POSSIBLE_LCD_ADDRESSES[] = {0x27, 0x3F} — это два самых распространённых адреса
  // i = 0: проверяем адрес 0x27
  // i = 1: проверяем адрес 0x3F
  for (int i = 0; i < NUM_POSSIBLE_ADDRESSES; i++) {
    
    // Берём очередной адрес из массива
    uint8_t address = POSSIBLE_LCD_ADDRESSES[i];
    
    // Wire.beginTransmission(address) — начинаем передачу на указанный адрес
    // I2C шина: Arduino (мастер) обращается к устройству с адресом address
    Wire.beginTransmission(address);
    
    // Wire.endTransmission() — завершаем передачу и получаем код ошибки
    // error = 0: устройство ответило (успех)
    // error != 0: устройство не ответило (ошибка)
    byte error = Wire.endTransmission();
    
    // Если ошибки нет (error == 0) — значит устройство на этом адресе есть
    if (error == 0) {
      foundAddress = address;  // Сохраняем найденный адрес
      Serial.print("Дисплей найден на адресе 0x");
      Serial.println(address, HEX);  // HEX — выводим в шестнадцатеричном формате
      break;  // Выходим из цикла (дальше искать не нужно)
    }
  }
  
  // ---------- ШАГ 2: ИНИЦИАЛИЗАЦИЯ ДИСПЛЕЯ (если он найден) ----------
  if (foundAddress != 0) {
    // Дисплей НАЙДЕН — приступаем к инициализации
    
    // Проверяем, существует ли уже объект дисплея (был создан раньше)
    // lcd != NULL означает "указатель не равен нулю" (указывает на существующий объект)
    if (lcd != NULL) {
      // Если объект существует — удаляем его из памяти
      // delete освобождает память, выделенную оператором new
      delete lcd;
      lcd = NULL;  // Устанавливаем указатель в NULL (теперь он ни на что не указывает)
      delay(100);  // Ждём 100 мс, чтобы память освободилась
    }
    
    // Создаём НОВЫЙ объект дисплея с найденным адресом
    // Параметры конструктора: адрес, ширина экрана (16 символов), высота (2 строки)
    lcd = new LiquidCrystal_I2C(foundAddress, 16, 2);
    
    // ---------- ИНИЦИАЛИЗАЦИЯ С ЗАЩИТОЙ ОТ ЗАВИСАНИЯ ----------
    // Все операции с дисплеем разбиты на короткие шаги с паузами
    // Это предотвращает зависание, если дисплей отвечает медленно
    
    // lcd->init() — инициализация дисплея (внутренняя настройка)
    // Стрелка -> используется, потому что lcd — это указатель, а не сам объект
    lcd->init();
    delay(50);  // Короткая пауза 50 мс для стабилизации
    
    // lcd->backlight() — включаем подсветку дисплея
    lcd->backlight();
    delay(50);  // Короткая пауза
    
    // lcd->clear() — очищаем экран от мусора
    lcd->clear();
    delay(50);  // Короткая пауза
    
    // ---------- ТЕСТОВОЕ СООБЩЕНИЕ ----------
    // Устанавливаем курсор в начало первой строки (столбец 0, строка 0)
    lcd->setCursor(0, 0);
    lcd->print("LCD Ready");  // Печатаем текст (только английские буквы)
    
    // Устанавливаем курсор во вторую строку (столбец 0, строка 1)
    lcd->setCursor(0, 1);
    lcd->print("Addr: 0x");
    lcd->print(foundAddress, HEX);  // Печатаем адрес в шестнадцатеричном формате
    
    // ---------- ВАЖНО: сбрасываем watchdog во время паузы ----------
    // Если просто поставить delay(1000), watchdog может перезагрузить Arduino
    // Поэтому делаем цикл из 10 коротких пауз по 100 мс с сбросом watchdog
    for (int i = 0; i < 10; i++) {
      delay(100);      // Пауза 100 мс
      wdt_reset();     // Сбрасываем watchdog каждые 100 мс
    }
    
    // Переключаем дисплей в нормальный режим работы
    // currentDisplayMode — переменная, которая хранит состояние дисплея
    // DISPLAY_NORMAL = 0 — дисплей работает нормально
    currentDisplayMode = DISPLAY_NORMAL;
    
    // Выводим сообщение об успешной инициализации в Serial монитор
    Serial.println("Дисплей инициализирован");
    
  } else {
    // ---------- ДИСПЛЕЙ НЕ НАЙДЕН ----------
    // Переходим в режим восстановления (будем пытаться снова в loop())
    // DISPLAY_RECOVERING = 1 — дисплей не работает, пытаемся восстановить
    currentDisplayMode = DISPLAY_RECOVERING;
    
    // Выводим сообщение об ошибке
    Serial.println("Дисплей не найден, буду пытаться в основном цикле");
  }
  
  // Сбрасываем watchdog после всей инициализации дисплея
  // Если какой-то шаг занял много времени, watchdog не перезагрузит Arduino
  wdt_reset();


  // -------------------------------------------------------------------
  // БЛОК 7: НАСТРОЙКА ДАТЧИКА ТЕМПЕРАТУРЫ И ВЛАЖНОСТИ DHT11
  // -------------------------------------------------------------------
  // dht.begin() - инициализация датчика DHT11
  // Устанавливает пин DHT_PIN (пин 2) как вход, отправляет стартовый сигнал датчику
  dht.begin();
  wdt_reset();                      // Сбрасываем watchdog


  // -------------------------------------------------------------------
  // БЛОК 8: НАСТРОЙКА ПИНОВ ДЛЯ ИСПОЛНИТЕЛЬНЫХ УСТРОЙСТВ
  // -------------------------------------------------------------------
  // pinMode(пин, OUTPUT) - настраивает пин как выход
  // Arduino будет подавать напряжение на эти пины для управления устройствами
  pinMode(PUMP_PIN, OUTPUT);        // Пин насоса (3) как выход
  pinMode(LED_GROW_PIN, OUTPUT);    // Пин фитоленты (5) как выход
  wdt_reset();                      // Сбрасываем watchdog


  // -------------------------------------------------------------------
  // БЛОК 9: НАСТРОЙКА ПИНОВ ДАТЧИКА ВОДЫ (С ИМПУЛЬСНЫМ ПИТАНИЕМ)
  // -------------------------------------------------------------------
  // Датчик воды HCW-M203 подключается к 12В через реле
  // Реле управляется с пина 8, включая питание датчика только на время измерения
  // Это предотвращает электролиз медных проводов (не будет синего осадка)
  
  pinMode(WATER_SENSOR_PIN, INPUT_PULLUP);     // Сигнальный пин как вход
  pinMode(WATER_SENSOR_RELAY_PIN, OUTPUT);     // Пин реле как выход
  digitalWrite(WATER_SENSOR_RELAY_PIN, HIGH);  // HIGH = реле ВЫКЛЮЧЕНО (безопасное состояние)
  wdt_reset();                      // Сбрасываем watchdog


  // -------------------------------------------------------------------
  // БЛОК 10: УСТАНОВКА НАЧАЛЬНОГО СОСТОЯНИЯ (ВСЕ ВЫКЛЮЧЕНЫ)
  // -------------------------------------------------------------------
  // При запуске все исполнительные устройства должны быть ВЫКЛЮЧЕНЫ
  // Это безопасное состояние — ничего не работает без команды
  digitalWrite(PUMP_PIN, LOW);      // Насос выключен (LOW = ВЫКЛ)
  digitalWrite(LED_GROW_PIN, LOW);  // Фитолента выключена
  wdt_reset();                      // Сбрасываем watchdog


  // -------------------------------------------------------------------
  // БЛОК 11: НАСТРОЙКА СЕРВОПРИВОДА (ФОРТОЧКА)
  // -------------------------------------------------------------------
  // ventServo.attach(SERVO_PIN) - привязываем объект серво к пину 4
  // attach() инициализирует таймер для генерации PWM сигнала (широтно-импульсной модуляции)
  ventServo.attach(SERVO_PIN);
  ventServo.write(SERVO_CLOSED);    // Устанавливаем угол 0° (закрыто)
  delay(500);                       // Ждём 500 мс, пока серво повернётся
  wdt_reset();                      // Сбрасываем watchdog


  // -------------------------------------------------------------------
  // БЛОК 12: ВЫВОД ИНФОРМАЦИИ О НАСТРОЙКАХ В SERIAL МОНИТОР
  // -------------------------------------------------------------------
  Serial.println("\n=== SYSTEM SETTINGS ===");
  Serial.print("Water plants when soil < "); Serial.print(SOIL_DRY); Serial.println("%");
  Serial.print("Open window when temperature > "); Serial.print(OPEN_TEMP); Serial.println("C");
  Serial.print("Turn on grow light when darkness > "); Serial.print(DARK_THRESHOLD); Serial.println("%");
  wdt_reset();                      // Сбрасываем watchdog


  // -------------------------------------------------------------------
  // БЛОК 13: ТЕСТИРОВАНИЕ РЕЛЕ ФИТОЛЕНТЫ (разбиваем на части!)
  // -------------------------------------------------------------------
  // Проверяем, работает ли реле фитоленты: включаем на 1 секунду, потом выключаем
  // delay(1000) = 1 секунда, что меньше таймаута watchdog (2 секунды), но для надёжности
  // всё равно разбиваем на цикл из 10 коротких пауз по 100 мс
  Serial.println("\nTesting grow light relay...");
  
  // Включаем фитоленту
  digitalWrite(LED_GROW_PIN, HIGH); // HIGH = ВКЛ (RELAY_INVERTED = false)
  for (int i = 0; i < 10; i++) {    // 10 раз по 100 мс = 1000 мс (1 секунда)
    delay(100);
    wdt_reset();                    // Сбрасываем watchdog каждые 100 мс
  }
  
  // Выключаем фитоленту
  digitalWrite(LED_GROW_PIN, LOW);   // LOW = ВЫКЛ
  for (int i = 0; i < 10; i++) {    // 10 раз по 100 мс = 1000 мс (1 секунда)
    delay(100);
    wdt_reset();                    // Сбрасываем watchdog каждые 100 мс
  }
  wdt_reset();                      // Сбрасываем watchdog после теста


  // -------------------------------------------------------------------
  // БЛОК 14: ВЫВОД СТАТУСА ДАТЧИКОВ (ЧТО ВКЛЮЧЕНО, ЧТО ОТКЛЮЧЕНО)
  // -------------------------------------------------------------------
  // Используем макросы #if ... #endif для условной компиляции
  // Если датчик отключен в разделе 4, этот код даже не попадёт в прошивку
  Serial.println("\n=== SENSOR STATUS ===");
  #if ENABLE_DHT
  Serial.println("DHT11 temperature/humidity sensor: ENABLED");
  #endif
  #if ENABLE_SOIL
  Serial.println("Soil moisture sensor: ENABLED");
  #endif
  #if ENABLE_LIGHT
  Serial.println("Light sensor: ENABLED");
  #endif
  #if ENABLE_WATER
  Serial.println("Water level sensor: ENABLED");
  #endif
  wdt_reset();                      // Сбрасываем watchdog


  // -------------------------------------------------------------------
  // БЛОК 15: ПРИВЕТСТВЕННОЕ СООБЩЕНИЕ НА ДИСПЛЕЕ
  // -------------------------------------------------------------------
  // Проверяем, находится ли дисплей в нормальном режиме
  if (currentDisplayMode == DISPLAY_NORMAL) {
    lcd->clear();                   // Очищаем экран
    lcd->setCursor(0, 0);           // Курсор в начало первой строки
    lcd->print("Smart Greenhouse"); // Печатаем название системы
    lcd->setCursor(0, 1);           // Курсор в начало второй строки
    lcd->print("System Ready");     // Печатаем статус
    
    // delay(2000) = 2 секунды — это РОВНО таймаут watchdog!
    // Если оставить просто delay(2000), watchdog может успеть перезагрузить Arduino.
    // Поэтому разбиваем на 20 раз по 100 мс с сбросом watchdog.
    for (int i = 0; i < 20; i++) {
      delay(100);
      wdt_reset();                  // Сбрасываем watchdog каждые 100 мс
    }
  }
  wdt_reset();                      // Сбрасываем watchdog


  // -------------------------------------------------------------------
  // БЛОК 16: ИНИЦИАЛИЗАЦИЯ ТАЙМЕРОВ (ВРЕМЕННЫХ ПЕРЕМЕННЫХ)
  // -------------------------------------------------------------------
  // Запоминаем текущее время для смены экранов дисплея (каждые 3 секунды)
  lastDisplayChange = millis();
  
  // Запоминаем время успешной работы дисплея (для авто-восстановления при зависании)
  lastDisplaySuccess = millis();
  
  // Инициализируем время последнего полива
  // millis() - возвращает количество миллисекунд с момента включения Arduino
  // Устанавливаем lastWatering = текущее время, чтобы насос не начал поливать сразу при старте
  // Насос включится только когда пройдёт 10 минут (WATERING_COOLDOWN = 600000 мс)
  lastWatering = millis();
  
  wdt_reset();                      // Сбрасываем watchdog


  // -------------------------------------------------------------------
  // БЛОК 17: ФИНАЛЬНЫЕ СООБЩЕНИЯ
  // -------------------------------------------------------------------
  Serial.println("\n=== SYSTEM READY ===");
  
  // Пауза 2 секунды для чтения сообщений в мониторе порта
  // Снова разбиваем на 20 раз по 100 мс для безопасности watchdog
  for (int i = 0; i < 20; i++) {
    delay(100);
    wdt_reset();                    // Сбрасываем watchdog каждые 100 мс
  }
  
  // Очищаем экран перед началом основной работы
  if (currentDisplayMode == DISPLAY_NORMAL) {
    lcd->clear();
  }
  
  // ПОСЛЕДНИЙ СБРОС WATCHDOG ПЕРЕД ВХОДОМ В LOOP()
  // Если все настройки прошли успешно, сбрасываем watchdog и переходим в основной цикл
  wdt_reset();
  
} // КОНЕЦ ФУНКЦИИ setup()


// =====================================================================
// КРАТКОЕ ОПИСАНИЕ ИЗМЕНЕНИЙ В РАЗДЕЛЕ 11
// =====================================================================
/*
  ЧТО БЫЛО (проблема):
  ------------------------------------------------
  - delay(3000) — 3 секунды > таймаута watchdog (2 секунды)
  - delay(2000) — 2 секунды = таймауту watchdog (на грани)
  - watchdog срабатывал во время инициализации и перезагружал Arduino
  - теплица зависала при включении или вообще не запускалась

  ЧТО СТАЛО (решение):
  ------------------------------------------------
  1. Все длинные задержки (>100 мс) разбиты на циклы:
     - delay(3000) → цикл 30×100 мс с wdt_reset()
     - delay(2000) → цикл 20×100 мс с wdt_reset()
     - delay(1000) → цикл 10×100 мс с wdt_reset()
  
  2. wdt_reset() добавлен после КАЖДОГО важного шага инициализации
  
  3. Внутри циклов мигания светодиодом добавлен wdt_reset()
  
  4. В начале setup() добавлен wdt_enable(WDTO_2S) для активации watchdog

  ПОЧЕМУ ЭТО ВАЖНО:
  ------------------------------------------------
  - Watchdog теперь НЕ срабатывает во время инициализации
  - Система успевает полностью запуститься
  - При реальном зависании в loop() watchdog всё равно перезагрузит Arduino
  - Теплица становится самовосстанавливающейся

  ТЕПЕРЬ ТЕПЛИЦА:
  ------------------------------------------------
  - Запускается без зависаний
  - Watchdog защищает от зависаний в основной программе
  - При проблемах с дисплеем или другими устройствами — автоматическая перезагрузка
*/


// =====================================================================
// ПОЯСНЕНИЕ РАБОТЫ ПЕРЕМЕННОЙ lastWatering
// =====================================================================
/*
  lastWatering хранит время последнего ОКОНЧАНИЯ полива в миллисекундах.
  
  Почему это важно:
  - При старте Arduino lastWatering = millis() (текущее время)
  - Если millis() вернула 5000 (5 секунд после включения), то lastWatering = 5000
  - Для включения насоса нужно: currentTime - lastWatering > WATERING_COOLDOWN
  - WATERING_COOLDOWN = 600000 (10 минут = 600 000 миллисекунд)
  - Значит, насос включится только когда currentTime - 5000 > 600000
  - То есть когда currentTime > 605000 (через 10 минут и 5 секунд после старта)
  
  Это гарантирует, что насос НЕ включится сразу после подачи питания,
  а подождёт как минимум 10 минут (или дольше, если почва влажная).
*/


// =====================================================================
// РАЗДЕЛ 12: ЧТЕНИЕ ВСЕХ ДАТЧИКОВ (С ЗАЩИТАМИ И ФИЛЬТРАЦИЕЙ)
// =====================================================================

// Функция для чтения всех датчиков
void readSensors() {
  
  // ===== 1. ДАТЧИК DHT11 (ТЕМПЕРАТУРА И ВЛАЖНОСТЬ ВОЗДУХА) =====
  #if ENABLE_DHT
  // Статическая переменная для хранения времени последнего чтения
  // static - сохраняет значение между вызовами функции (не обнуляется каждый раз)
  static unsigned long lastDHTReadTime = 0;
  
  // Получаем текущее время в миллисекундах
  unsigned long currentTime = millis();
  
  // ВАЖНО: DHT11 требует минимум 2 СЕКУНДЫ между чтениями!
  // Если читать чаще - он будет возвращать старые значения или ошибку
  const unsigned long DHT_MIN_INTERVAL = 2000;  // 2000 мс = 2 секунды
  
  // Проверяем, прошло ли достаточно времени с последнего чтения
  if (currentTime - lastDHTReadTime >= DHT_MIN_INTERVAL) {
    // Обновляем время последнего чтения
    lastDHTReadTime = currentTime;
    
    // ЧИТАЕМ ДАТЧИК
    // dht.readTemperature() - возвращает температуру в градусах Цельсия
    // Если датчик не отвечает, возвращает NaN (Not a Number)
    float tempRaw = dht.readTemperature();
    
    // dht.readHumidity() - возвращает влажность в процентах
    float humidityRaw = dht.readHumidity();
    
    // ПРОВЕРЯЕМ НА ОШИБКИ
    // isnan() - проверяет, является ли значение NaN
    if (isnan(tempRaw) || isnan(humidityRaw)) {
      // Если ошибка чтения (датчик не ответил)
      Serial.println("DHT11: READ ERROR - Sensor not responding!");
      
      // Увеличиваем счетчик ошибок
      dhtErrorCount++;
      
      // Если ошибок слишком много (больше MAX_DHT_ERRORS)
      if (dhtErrorCount > MAX_DHT_ERRORS) {
        Serial.println("DHT11: Too many errors! Sensor may be dead.");
      }
      
      // Не обновляем фильтрованные значения при ошибке
      // Просто выходим из блока (не применяем фильтрацию)
      // return не делаем, продолжаем чтение других датчиков
    } else {
      // ДАТЧИК ВЕРНУЛ КОРРЕКТНЫЕ ЗНАЧЕНИЯ
      
      // ВЫВОД СЫРЫХ ЗНАЧЕНИЙ ДЛЯ ДИАГНОСТИКИ
      Serial.print("DHT11: RAW - Temp=");
      Serial.print(tempRaw);
      Serial.print("C, Humidity=");
      Serial.print(humidityRaw);
      Serial.println("%");
      
      // ПРОВЕРКА НА ЗАЛИПАНИЕ (DHT11 иногда залипает на одном значении)
      // Статические переменные для хранения предыдущих значений
      static float prevTemp = 25.0;
      static float prevHumidity = 60.0;
      static int sameValueCount = 0;
      
      // Проверяем, изменились ли значения (с учётом погрешности 0.1)
      float tempDelta = abs(tempRaw - prevTemp);
      float humidityDelta = abs(humidityRaw - prevHumidity);
      
      if (tempDelta < 0.1 && humidityDelta < 0.1) {
        // Значения почти не изменились (залипание)
        sameValueCount++;
        Serial.print("DHT11: Values not changing! Count=");
        Serial.println(sameValueCount);
        
        // Если значения не менялись 5 раз подряд (15 секунд)
        if (sameValueCount >= 5) {
          Serial.println("DHT11: HARD RESET ATTEMPT...");
          
          // Жёсткий сброс: создаём новый объект датчика
          // В Arduino нельзя просто удалить объект, но можно заново инициализировать
          dht.begin();  // Переинициализация
          delay(100);
          dht.begin();  // Двойная переинициализация для уверенности
          delay(2000);   // Ждём 2 секунды после сброса
          
          // Сбрасываем счётчик
          sameValueCount = 0;
          
          // Не обновляем значения после сброса (подождём следующего цикла)
          return;  // Выходим из функции readSensors(), но не из loop()
        }
      } else {
        // Значения изменились - датчик работает нормально
        if (sameValueCount > 0) {
          Serial.println("DHT11: Values changed - sensor OK");
          sameValueCount = 0;
        }
        
        // Сохраняем текущие значения для следующего сравнения
        prevTemp = tempRaw;
        prevHumidity = humidityRaw;
        
        // Сбрасываем счётчик ошибок
        dhtErrorCount = 0;
        
        // ПРИМЕНЯЕМ ФИЛЬТРАЦИЮ
        // applyFilter(старое, новое, коэффициент)
        // коэффициент 0.3 = 70% старого + 30% нового
        tempFiltered = applyFilter(tempFiltered, tempRaw, FILTER_COEFF);
        humidityFiltered = applyFilter(humidityFiltered, humidityRaw, FILTER_COEFF);
        
        // ВЫВОД ОТФИЛЬТРОВАННЫХ ЗНАЧЕНИЙ
        Serial.print("DHT11: FILTERED - Temp=");
        Serial.print(tempFiltered);
        Serial.print("C, Humidity=");
        Serial.print(humidityFiltered);
        Serial.println("%");
      }
    }
  } else {
    // Ещё не прошло 2 секунды - пропускаем чтение (это нормально)
    // Выводим сообщение раз в 10 секунд (чтобы не засорять монитор порта)
    static unsigned long lastSkipMessage = 0;
    if (currentTime - lastSkipMessage > 10000) {
      lastSkipMessage = currentTime;
      Serial.println("DHT11: Waiting 2 seconds between readings...");
    }
  }
  #endif  // Конец блока #if ENABLE_DHT
  
  
  // 2. ЧТЕНИЕ ВЛАЖНОСТИ ПОЧВЫ
  #if ENABLE_SOIL
    // Получаем стабильное значение датчика почвы (0-1023)
    int soilRaw = readSoilMoistureStable();
  
    // ПРЕОБРАЗОВАНИЕ В ПРОЦЕНТЫ
    // ВАЖНО: первое число должно быть МЕНЬШЕ второго!
    // У вас: мокрая (233) < сухая (554) → правильно
    int soilPercent = map(soilRaw, SOIL_DRY_CALIB, SOIL_WET_CALIB, 0, 100);
    //                           мокрая(233)     сухая(554)      0%    100%
  
    // Ограничиваем значение между 0 и 100%
    soilPercent = constrain(soilPercent, 0, 100);
  
    // Применяем фильтр сглаживания
    soilMoistureFiltered = (int)applyFilter((float)soilMoistureFiltered, (float)soilPercent, FILTER_COEFF * 0.2);
  
    // ОТЛАДКА (удалите после проверки)
    static unsigned long lastDebug = 0;
    if (millis() - lastDebug > 5000) {
      lastDebug = millis();
      Serial.print("SOIL: raw=");
      Serial.print(soilRaw);
      Serial.print(" → percent=");
      Serial.print(soilPercent);
      Serial.print(" → filtered=");
      Serial.println(soilMoistureFiltered);
    }
  #endif
  
  
  // ===== 3. ДАТЧИК ОСВЕЩЁННОСТИ (ФОТОРЕЗИСТОР) =====
  #if ENABLE_LIGHT
  // Получаем усреднённое значение датчика освещённости
  int lightRaw = readAnalogSensorStable(LIGHT_SENSOR_PIN);
  
  // Преобразуем в проценты (инвертированное преобразование)
  // Ваш датчик инвертированный: темно → большое значение (0), светло → маленькое (675)
  // Поэтому преобразуем: темно (0) → 100%, светло (675) → 0%
  int lightPercent = map(lightRaw, DARK_VALUE, BRIGHT_VALUE, 100, 0);
  
  // Ограничиваем значение 0-100%
  lightPercent = constrain(lightPercent, 0, 100);
  
  // Применяем фильтр сглаживания
  lightLevelFiltered = (int)applyFilter((float)lightLevelFiltered, (float)lightPercent, FILTER_COEFF);
  
  // Отладочный вывод
  static unsigned long lastLightDebug = 0;
  if (millis() - lastLightDebug > 60000) {  // Раз в минуту
    lastLightDebug = millis();
    Serial.print("LIGHT: raw=");
    Serial.print(lightRaw);
    Serial.print(" percent=");
    Serial.print(lightPercent);
    Serial.print(" filtered=");
    Serial.println(lightLevelFiltered);
  }
  #else
  // Если датчик освещённости отключен - тестовое значение 50%
  lightLevelFiltered = 50;
  #endif
  
  
  // =====================================================================
// 4. ДАТЧИК УРОВНЯ ВОДЫ (УЛУЧШЕННАЯ ВЕРСИЯ)
  // =====================================================================
  // Эта версия использует "метод большинства" для определения состояния.
  // Вместо того чтобы ждать стабильности, она смотрит: сколько раз из 10
  // датчик показал HIGH (вода). Если 6 и более - вода есть, если 4 и менее - воды нет.
  // Если ровно 5 - состояние не меняется (избегаем "дребезга" на границе).
  // =====================================================================

  #if ENABLE_WATER  // Если датчик воды ВКЛЮЧЕН в настройках (раздел 4)

    // -----------------------------------------------------------------
    // ЧАСТЬ 1: СТАТИЧЕСКИЕ ПЕРЕМЕННЫЕ
    // -----------------------------------------------------------------
    // static - переменные сохраняют значения между вызовами функции
    // Они инициализируются только один раз при первом вызове
    
    static bool pinConfigured = false;
    // pinConfigured - флаг, настроены ли уже пины датчика
    // false = ещё не настраивали, true = уже настроили
    // Нужно чтобы настроить пины ТОЛЬКО ОДИН РАЗ
    
    static unsigned long lastWaterReadTime = 0;
    // lastWaterReadTime - время последнего измерения в миллисекундах
    // Используется для ограничения частоты опроса (не чаще 1 раза в 5 секунд)
    
    // -----------------------------------------------------------------
    // ЧАСТЬ 2: НАСТРОЙКА ПИНОВ (ВЫПОЛНЯЕТСЯ ТОЛЬКО 1 РАЗ)
    // -----------------------------------------------------------------
    // if (!pinConfigured) - "ЕСЛИ пины НЕ настроены"
    // ! означает логическое НЕ (если pinConfigured == false)
    
    if (!pinConfigured) {
      
      // pinMode(пин, режим) - настраивает пин как ВХОД или ВЫХОД
      
      // INPUT - пин будет ЧИТАТЬ сигналы (0 или 5В)
      // WATER_SENSOR_PIN = 6 - сигнальный провод датчика
      pinMode(WATER_SENSOR_PIN, INPUT);
      
      // OUTPUT - пин будет ПОДАВАТЬ напряжение (для управления реле)
      // WATER_SENSOR_RELAY_PIN = 8 - управление реле питания датчика
      pinMode(WATER_SENSOR_RELAY_PIN, OUTPUT);
      
      // digitalWrite(пин, HIGH) - устанавливаем на пине 5В
      // HIGH = 5В = реле ВЫКЛЮЧЕНО (питание на датчик НЕ подаётся)
      // Это безопасное начальное состояние
      digitalWrite(WATER_SENSOR_RELAY_PIN, HIGH);
      
      // Устанавливаем флаг, что пины настроены
      // При следующем вызове этот блок НЕ выполнится
      pinConfigured = true;
    }
    
    // -----------------------------------------------------------------
    // ЧАСТЬ 3: ПОЛУЧАЕМ ТЕКУЩЕЕ ВРЕМЯ
    // -----------------------------------------------------------------
    // millis() - возвращает количество миллисекунд с момента включения
    unsigned long currentMillis = millis();
    
    // -----------------------------------------------------------------
    // ЧАСТЬ 4: ПРОВЕРКА - ПРОШЛО ЛИ 5 СЕКУНД?
    // -----------------------------------------------------------------
    // Если разница между текущим временем и временем последнего измерения
    // больше или равна 5000 миллисекунд (5 секунд) - пора измерять снова
    
    if (currentMillis - lastWaterReadTime >= 5000) {
      
      // ЗАПОМИНАЕМ ВРЕМЯ ЭТОГО ИЗМЕРЕНИЯ
      // Следующее измерение будет через 5 секунд
      lastWaterReadTime = currentMillis;
      
      // -----------------------------------------------------------------
      // ЧАСТЬ 5: ВКЛЮЧАЕМ ПИТАНИЕ ДАТЧИКА
      // -----------------------------------------------------------------
      // Подаём питание 12В на датчик через реле
      // RELAY_INVERTED = true (из настроек), значит:
      // LOW (0В) = реле ВКЛЮЧЕНО, HIGH (5В) = реле ВЫКЛЮЧЕНО
      
      digitalWrite(WATER_SENSOR_RELAY_PIN, LOW);
      // LOW = 0В = реле включается = на датчик подаётся 12В
      
      // ЖДЁМ СТАБИЛИЗАЦИИ ДАТЧИКА
      // delay(30) - пауза 30 миллисекунд
      // За это время датчик успевает "проснуться" и выдать стабильный сигнал
      // 30 мс достаточно для HCW-M203, больше не нужно (избегаем электролиза)
      delay(30);
      
      // -----------------------------------------------------------------
      // ЧАСТЬ 6: МНОЖЕСТВЕННОЕ ЧТЕНИЕ (10 раз подряд)
      // -----------------------------------------------------------------
      // Создаём массив для хранения 10 показаний
      // int readings[10] - массив из 10 целых чисел
      int readings[10];
      
      // Цикл for - повторяем блок кода 10 раз
      // i = 0,1,2,3,4,5,6,7,8,9
      for (int i = 0; i < 10; i++) {
        
        // digitalRead() - читает значение на пине
        // Возвращает HIGH (1) если вода есть, LOW (0) если воды нет
        readings[i] = digitalRead(WATER_SENSOR_PIN);
        
        // delay(2) - пауза 2 мс между чтениями
        // Это даёт время датчику "успокоиться" между измерениями
        delay(2);
      }
      
      // -----------------------------------------------------------------
      // ЧАСТЬ 7: ВЫКЛЮЧАЕМ ПИТАНИЕ ДАТЧИКА
      // -----------------------------------------------------------------
      // Питание было включено всего ~50 мс (30 + 10*2 = 50 мс)
      // Этого достаточно для измерения, но слишком мало для электролиза
      // Электролиз - это когда постоянный ток вызывает коррозию проводов
      
      digitalWrite(WATER_SENSOR_RELAY_PIN, HIGH);
      // HIGH = 5В = реле ВЫКЛЮЧАЕТСЯ = питание 12В отключается
      
      // -----------------------------------------------------------------
      // ЧАСТЬ 8: ПОДСЧЁТ HIGH (сколько раз датчик показал воду)
      // -----------------------------------------------------------------
      // Переменная для подсчёта
      int highCount = 0;
      
      // Проходим по всем 10 показаниям
      for (int i = 0; i < 10; i++) {
        // Если показание равно HIGH (вода есть)
        if (readings[i] == HIGH) {
          highCount++;  // Увеличиваем счётчик на 1
        }
      }
      
      // -----------------------------------------------------------------
      // ЧАСТЬ 9: НОВАЯ ЛОГИКА - МЕТОД БОЛЬШИНСТВА
      // -----------------------------------------------------------------
      // ВАЖНО: вместо того чтобы ждать стабильности (как в старом коде),
      // мы просто смотрим - сколько раз из 10 датчик показал воду.
      //
      // Логика:
      // - 6,7,8,9,10 HIGH → вода есть (FULL)
      // - 0,1,2,3,4 HIGH → воды нет (EMPTY)
      // - 5 HIGH → 50/50, не меняем состояние (предотвращает дребезг)
      
      bool newState = waterPresent;  // По умолчанию не меняем состояние
      
      // Если 6 и более HIGH из 10 - вода есть
      if (highCount >= 6) {
        newState = true;   // Устанавливаем FULL
      }
      // Если 4 и менее HIGH из 10 - воды нет
      else if (highCount <= 4) {
        newState = false;  // Устанавливаем EMPTY
      }
      // Если highCount == 5 - ничего не делаем (оставляем как было)
      
      // -----------------------------------------------------------------
      // ЧАСТЬ 10: ПРИМЕНЯЕМ ИЗМЕНЕНИЕ (если оно нужно)
      // -----------------------------------------------------------------
      // Проверяем: новое состояние отличается от текущего?
      if (newState != waterPresent) {
        
        // Обновляем глобальную переменную waterPresent
        // Эту переменную используют другие функции (полив, дисплей)
        waterPresent = newState;
        
        // Выводим сообщение в Serial монитор
        Serial.print("WATER: State changed to ");
        if (waterPresent) {
          Serial.println("FULL");
        } else {
          Serial.println("EMPTY");
        }
        
        // Показываем статистику (сколько HIGH из 10)
        Serial.print("  (highCount=");
        Serial.print(highCount);
        Serial.println("/10)");
      }
      
      // -----------------------------------------------------------------
      // ЧАСТЬ 11: ОТЛАДОЧНЫЙ ВЫВОД (каждые 30 секунд)
      // -----------------------------------------------------------------
      // static int debugCounter - счётчик для отладки
      // static - сохраняет значение между вызовами
      static int debugCounter = 0;
      
      // Увеличиваем счётчик на 1 при каждом измерении
      debugCounter++;
      
      // Если сделано 6 измерений (6 × 5 секунд = 30 секунд)
      if (debugCounter >= 6) {
        debugCounter = 0;  // Сбрасываем счётчик
        
        // Выводим сырые показания (H = HIGH, L = LOW)
        Serial.print("WATER DEBUG: readings=");
        for (int i = 0; i < 10; i++) {
          // Тернарный оператор ? :
          // Если readings[i] == HIGH → печатаем "H", иначе "L"
          Serial.print(readings[i] ? "H" : "L");
        }
        
        // Выводим количество HIGH
        Serial.print(" highCount=");
        Serial.print(highCount);
        
        // Выводим текущее состояние
        Serial.print(" state=");
        Serial.println(waterPresent ? "FULL" : "EMPTY");
      }
    }
    
  #else  // Если ENABLE_WATER = false (датчик воды ОТКЛЮЧЁН)
    
    // Если датчик отключён - считаем что вода ВСЕГДА ЕСТЬ
    // Это нужно чтобы полив продолжал работать без датчика
    waterPresent = true;
    
  #endif  // Конец #if ENABLE_WATER
}


// =====================================================================
// РАЗДЕЛ 13: УПРАВЛЕНИЕ ВЕНТИЛЯЦИЕЙ (ФОРТОЧКОЙ)
// =====================================================================

// Функция для управления форточкой на основе температуры
// Принцип работы: гистерезис с порогами OPEN_TEMP (28°C) и CLOSE_TEMP (26°C)
void controlWindow(float temperature) {
  // Проверка на ошибку датчика температуры
  // isnan() проверяет, является ли значение "не числом" (NaN)
  if (isnan(temperature)) {
    // Если температура некорректна - выводим сообщение об ошибке
    Serial.println("ERROR: Temperature sensor returned invalid value");
    // Выходим из функции (не выполняем дальнейший код)
    return;
  }
  
  // УСЛОВИЕ 1: ОТКРЫТЬ ФОРТОЧКУ
  // Проверяем, не пора ли открыть форточку:
  // 1. Температура >= порога открытия (28°C)
  // 2. Форточка сейчас закрыта (!windowIsOpen означает "НЕ открыта")
  if (temperature >= OPEN_TEMP && !windowIsOpen) {
    // Даём команду сервоприводу повернуться на угол SERVO_OPEN (90°)
    ventServo.write(SERVO_OPEN);
    
    // Ждём 500 мс, чтобы сервопривод успел повернуться
    delay(500);
    
    // Запоминаем текущий угол (для информации)
    ventAngle = SERVO_OPEN;
    
    // Запоминаем, что форточка теперь открыта (чтобы не посылать команду снова)
    windowIsOpen = true;
    
    // Выводим сообщение в Serial монитор
    Serial.print("VENTILATION: Opening window at ");
    Serial.print(temperature);
    Serial.println("C (too hot)");
    
    // Показываем сообщение на дисплее
    if (currentDisplayMode == DISPLAY_NORMAL) {
      lcd->clear();
      safePrint("TEMPERATURE HIGH", 0, 0);
      safePrint("OPENING WINDOW", 0, 1);
      delay(1000);
    }
  }
  
  // УСЛОВИЕ 2: ЗАКРЫТЬ ФОРТОЧКУ
  // Проверяем, не пора ли закрыть форточку:
  // 1. Температура <= порога закрытия (26°C)
  // 2. Форточка сейчас открыта
  else if (temperature <= CLOSE_TEMP && windowIsOpen) {
    // Даём команду сервоприводу повернуться на угол SERVO_CLOSED (0°)
    ventServo.write(SERVO_CLOSED);
    
    // Ждём 500 мс
    delay(500);
    
    // Запоминаем текущий угол
    ventAngle = SERVO_CLOSED;
    
    // Запоминаем, что форточка теперь закрыта
    windowIsOpen = false;
    
    // Выводим сообщение
    Serial.print("VENTILATION: Closing window at ");
    Serial.print(temperature);
    Serial.println("C (normal temp)");
    
    // Показываем сообщение на дисплее
    if (currentDisplayMode == DISPLAY_NORMAL) {
      lcd->clear();
      safePrint("TEMPERATURE OK", 0, 0);
      safePrint("CLOSING WINDOW", 0, 1);
      delay(1000);
    }
  }
  
  // Если температура между 26°C и 28°C - ничего не делаем
  // Форточка остаётся в текущем положении
  // Это гистерезис, предотвращает "дребезг" при температуре около порога
}


// =====================================================================
// РАЗДЕЛ 14: УПРАВЛЕНИЕ ВСЕМИ СИСТЕМАМИ ТЕПЛИЦЫ
// =====================================================================
// В этом разделе принимаются решения о включении/выключении:
// - Полива (насос)
// - Освещения (фитолента)
// - Вентиляции (форточка через сервопривод)
//
// ВАЖНО: RELAY_INVERTED = false (реле ОБЫЧНОЕ)
// Это означает: HIGH (5В) на пине = реле ВКЛЮЧЕНО (устройство работает)
//               LOW (0В) на пине = реле ВЫКЛЮЧЕНО (устройство выключено)
// =====================================================================

void controlSystems() {
  // millis() - возвращает количество миллисекунд с момента включения Arduino
  // currentTime - текущее "время" в миллисекундах (нужно для всех таймеров)
  unsigned long currentTime = millis();


  // =====================================================================
  // 1. УПРАВЛЕНИЕ ПОЛИВОМ (НАСОС)
  // =====================================================================
  // ЛОГИКА РАБОТЫ:
  //
  // УСЛОВИЯ ДЛЯ ВКЛЮЧЕНИЯ НАСОСА (ДОЛЖНЫ ВЫПОЛНИТЬСЯ ВСЕ):
  //   1) Почва СУХАЯ: влажность < SOIL_DRY = 40%
  //   2) В баке ЕСТЬ вода: waterPresent = true
  //   3) Прошло 10 минут с последнего полива (защита от частого полива)
  //
  // УСЛОВИЯ ДЛЯ ВЫКЛЮЧЕНИЯ НАСОСА (ДОСТАТОЧНО ЛЮБОГО):
  //   1) Прошло 2 секунды работы (нормальное выключение)
  //   2) Почва стала ВЛАЖНОЙ: влажность > SOIL_WET = 70%
  //   3) Вода закончилась в баке (аварийное отключение)
  //   4) Аварийный таймер: насос работает больше 30 секунд (защита от залипания)
  // =====================================================================

  // ----- ПРОВЕРКА: насос ВКЛЮЧЕН или ВЫКЛЮЧЕН? -----
  if (pumpState == true) {
    // ========== СЛУЧАЙ 1: НАСОС ВКЛЮЧЕН ==========
    // Проверяем условия для ВЫКЛЮЧЕНИЯ насоса
    
    // УСЛОВИЕ А: прошло больше PUMP_RUN_TIME (2 секунды) с момента включения?
    // Например: насос включился в момент времени 60000 мс
    // Текущее время 62000 мс → разница 2000 мс = 2 секунды → true
    bool timeCondition = (currentTime - pumpStartTime > PUMP_RUN_TIME);
    
    // УСЛОВИЕ Б: влажность почвы достигла или превысила SOIL_WET (70%)?
    // Почва стала достаточно влажной, полив больше не нужен
    bool moistureCondition = (soilMoistureFiltered >= SOIL_WET);
    
    // УСЛОВИЕ В: вода закончилась в баке?
    // !waterPresent означает "НЕ waterPresent" (true если waterPresent = false)
    bool noWaterCondition = (!waterPresent);
    
    // УСЛОВИЕ Г: аварийная защита (30 секунд)
    // Если датчик влажности сломался, насос не будет работать вечно
    bool emergencyCondition = (currentTime - pumpStartTime > MAX_PUMP_RUN_TIME);
    
    // ПРОВЕРКА: если выполнено ЛЮБОЕ из условий → выключаем насос
    if (timeCondition || moistureCondition || noWaterCondition || emergencyCondition) {
      
      // --- ВЫКЛЮЧАЕМ НАСОС ---
      // RELAY_INVERTED = false, поэтому LOW (0В) = ВЫКЛЮЧЕНО
      digitalWrite(PUMP_PIN, LOW);
      
      // Меняем состояние насоса на ВЫКЛЮЧЕН
      pumpState = false;
      
      // ==== ЗАПОМИНАЕМ ВРЕМЯ ВЫКЛЮЧЕНИЯ ====
      // lastWatering хранит время последнего ОКОНЧАНИЯ полива
      // Используется для таймера "отдыха" между поливами
      // БЕЗ ЭТОЙ СТРОЧКИ насос будет включаться снова и снова без остановки!
      lastWatering = currentTime;
      
      // --- ЛОГИРУЕМ ПРИЧИНУ ВЫКЛЮЧЕНИЯ (для отладки в Serial мониторе) ---
      if (timeCondition) {
        Serial.println("WATERING: Pump STOPPED - time elapsed (2 seconds)");
      }
      else if (moistureCondition) {
        Serial.println("WATERING: Pump STOPPED - soil is wet");
      }
      else if (noWaterCondition) {
        Serial.println("WATERING: Pump STOPPED - NO WATER in tank!");
        // Мигаем светодиодом для привлечения внимания (3 раза)
        for (int i = 0; i < 3; i++) {
          digitalWrite(STATUS_LED, HIGH);
          delay(100);
          digitalWrite(STATUS_LED, LOW);
          delay(100);
        }
      }
      else if (emergencyCondition) {
        Serial.println("WATERING: Pump STOPPED - EMERGENCY (30 sec timeout)");
      }
    }
    
  } else {
    // ========== СЛУЧАЙ 2: НАСОС ВЫКЛЮЧЕН ==========
    // Проверяем условия для ВКЛЮЧЕНИЯ насоса
    
    // УСЛОВИЕ 1: почва СУХАЯ? (влажность меньше SOIL_DRY = 40%)
    bool soilDryCondition = (soilMoistureFiltered < SOIL_DRY);
    
    // УСЛОВИЕ 2: в баке ЕСТЬ вода? (датчик воды, если отключён, waterPresent = true)
    bool waterPresentCondition = waterPresent;
    
    // УСЛОВИЕ 3: прошло больше 10 минут с последнего полива?
    // WATERING_COOLDOWN = 600000 мс (10 минут)
    // Пример: lastWatering = 60000 мс, currentTime = 660000 мс
    // 660000 - 60000 = 600000 мс = 10 минут → true
    bool cooldownCondition = (currentTime - lastWatering > WATERING_COOLDOWN);
    
    // ==== ВКЛЮЧАЕМ НАСОС ТОЛЬКО ЕСЛИ ВСЕ 3 УСЛОВИЯ ВЫПОЛНЕНЫ ====
    if (soilDryCondition && waterPresentCondition && cooldownCondition) {
      
      // --- ВКЛЮЧАЕМ НАСОС ---
      // RELAY_INVERTED = false, поэтому HIGH (5В) = ВКЛЮЧЕНО
      digitalWrite(PUMP_PIN, HIGH);
      
      // Меняем состояние насоса на ВКЛЮЧЕН
      pumpState = true;
      
      // ==== ЗАПОМИНАЕМ ВРЕМЯ ВКЛЮЧЕНИЯ ====
      // НУЖНО для контроля длительности работы (2 секунды)
      pumpStartTime = currentTime;
      
      // Также запоминаем время начала полива (для таймера отдыха)
      lastWatering = currentTime;
      
      // Логируем включение насоса
      Serial.print("WATERING: Pump STARTED (soil=");
      Serial.print(soilMoistureFiltered);
      Serial.println("% < 40%)");
      
      // Показываем сообщение на дисплее
      if (currentDisplayMode == DISPLAY_NORMAL) {
        lcd->clear();
        safePrint("WATERING", 0, 0);
        safePrint("ON", 0, 1);
        delay(500);
      }
    }
  }


  // =====================================================================
  // 2. УПРАВЛЕНИЕ ФИТОЛЕНТОЙ (ОСВЕЩЕНИЕ)
  // =====================================================================
  // ВНИМАНИЕ: Ваш датчик освещённости работает ИНВЕРТИРОВАННО:
  //   - В ТЕМНОТЕ (реально темно) → датчик показывает БОЛЬШОЙ процент (около 100%)
  //   - НА СВЕТУ (реально светло) → датчик показывает МАЛЕНЬКИЙ процент (около 0%)
  //
  // Поэтому пороги НАОБОРОТ:
  //   - Включаем фитоленту, когда lightLevelFiltered > DARK_THRESHOLD (80%)
  //   - Выключаем фитоленту, когда lightLevelFiltered < LIGHT_THRESHOLD (20%)
  //
  // ДОПОЛНИТЕЛЬНО: есть защита от обратной связи (свет лампы не должен влиять на датчик)
  // =====================================================================

  // -------------------------------------------------------------------
  // БЛОК 2.1: ЗАЩИТА ОТ ОБРАТНОЙ СВЯЗИ (ПРЕДОТВРАЩАЕТ МОРГАНИЕ ЛАМПЫ)
  // -------------------------------------------------------------------
  // Проблема: когда фитолента включается, её свет может попадать на датчик.
  // Датчик видит "свет" и пытается выключить лампу → лампа моргает.
  //
  // Решение: после включения лампы ЗАПРЕЩАЕМ её выключение в течение 15 секунд.
  // За это время свет лампы перестаёт влиять на датчик (или система стабилизируется).
  // -------------------------------------------------------------------

  // static unsigned long lastLampTurnOnTime = 0 - время последнего включения лампы
  // static означает, что переменная сохраняет значение между вызовами функции
  static unsigned long lastLampTurnOnTime = 0;

  // static bool lampJustTurnedOn = false - флаг блокировки выключения
  // true = лампа только что включилась, выключать НЕЛЬЗЯ
  // false = блокировка снята, можно выключать по условию
  static bool lampJustTurnedOn = false;


  // -------------------------------------------------------------------
  // БЛОК 2.2: ВКЛЮЧЕНИЕ ФИТОЛЕНТЫ
  // -------------------------------------------------------------------
  // Условие: освещённость ПОКАЗАЛА ТЕМНОТУ (>80%) И лампа сейчас выключена
  // Так как датчик инвертирован, "темнота" на датчике = 100% = реальная темнота
  // -------------------------------------------------------------------

  if (lightLevelFiltered > DARK_THRESHOLD && lampState == false) {
    
    // Включаем фитоленту: RELAY_INVERTED = false, поэтому HIGH = ВКЛ
    digitalWrite(LED_GROW_PIN, HIGH);
    
    // Запоминаем, что лампа теперь включена
    lampState = true;
    
    // Запоминаем время включения (нужно для защиты)
    lastLampTurnOnTime = millis();
    
    // Включаем блокировку выключения (лампа не выключится ближайшие 15 секунд)
    lampJustTurnedOn = true;
    
    // Отладочное сообщение в Serial монитор
    Serial.print("LIGHTING: ON (darkness detected, light=");
    Serial.print(lightLevelFiltered);
    Serial.println("%)");
  }


  // -------------------------------------------------------------------
  // БЛОК 2.3: ЗАЩИТА ОТ ОБРАТНОЙ СВЯЗИ (ЛОГИКА БЛОКИРОВКИ)
  // -------------------------------------------------------------------
  // Если лампа включена (lampState == true), проверяем, можно ли её выключать
  // -------------------------------------------------------------------

  else if (lampState == true) {
    
    // Сколько времени прошло с момента включения лампы?
    unsigned long timeSinceTurnOn = millis() - lastLampTurnOnTime;
    
    // -------------------------------------------------------------
    // Шаг 1: Снимаем блокировку через 15 секунд
    // -------------------------------------------------------------
    if (timeSinceTurnOn > 15000 && lampJustTurnedOn == true) {
      lampJustTurnedOn = false;   // Блокировка снята
      Serial.println("LIGHTING: Protection ended, lamp can now be turned off");
    }
    
    // -------------------------------------------------------------
    // Шаг 2: Выключаем лампу, если:
    //   1) Блокировка снята (lampJustTurnedOn == false)
    //   2) Датчик показывает СВЕТ (<20%) → значит реально светло
    // -------------------------------------------------------------
    if (lampJustTurnedOn == false && lightLevelFiltered < LIGHT_THRESHOLD) {
      
      // Выключаем фитоленту: RELAY_INVERTED = false, поэтому LOW = ВЫКЛ
      digitalWrite(LED_GROW_PIN, LOW);
      
      // Запоминаем, что лампа выключена
      lampState = false;
      
      // Отладочное сообщение
      Serial.print("LIGHTING: OFF (light detected, light=");
      Serial.print(lightLevelFiltered);
      Serial.println("%)");
    }
    
    // -------------------------------------------------------------
    // Шаг 3: Отладка (показывает, сколько осталось до снятия блокировки)
    // -------------------------------------------------------------
    else if (lampJustTurnedOn == true) {
      static unsigned long lastDebug = 0;
      if (millis() - lastDebug > 5000) {  // Сообщение раз в 5 секунд
        lastDebug = millis();
        unsigned long secondsLeft = (15000 - timeSinceTurnOn) / 1000;
        if (secondsLeft > 0) {
          Serial.print("LIGHTING: Protection active, ignoring sensor for ");
          Serial.print(secondsLeft);
          Serial.println(" more seconds");
        }
      }
    }
  }


  // =====================================================================
  // 3. УПРАВЛЕНИЕ ВЕНТИЛЯЦИЕЙ (ФОРТОЧКА)
  // =====================================================================
  // Вызываем отдельную функцию controlWindow(), которая управляет сервоприводом
  // Передаём текущую температуру для принятия решения
  controlWindow(tempFiltered);
  
} // КОНЕЦ ФУНКЦИИ controlSystems()


// =====================================================================
// КРАТКОЕ РЕЗЮМЕ ДЛЯ ПОНИМАНИЯ ВСЕГО РАЗДЕЛА
// =====================================================================
/*
  КАК РАБОТАЕТ ПОЛИВ (НАСОС):
  ---------------------------------
  1. Насос включается, когда:
     - Почва сухая (<40%)
     - Есть вода в баке
     - Прошло 10 минут с последнего полива
  
  2. Насос выключается, когда:
     - Прошло 2 секунды работы (норма)
     - Почва стала влажной (>70%)
     - Закончилась вода
     - Авария (работает >30 секунд)


  КАК РАБОТАЕТ ФИТОЛЕНТА:
  ---------------------------------
  1. Включается, когда датчик показывает "темноту" (>80%):
     - Это значит, что реально темно
     - После включения включается блокировка на 15 секунд
  
  2. В течение 15 секунд после включения:
     - Лампа НЕ может выключиться (блокировка)
     - Это даёт время свету лампы перестать влиять на датчик
  
  3. Через 15 секунд:
     - Блокировка снимается
     - Если датчик показывает "свет" (<20%) → лампа выключается
     - Если всё ещё "темно" → лампа продолжает гореть


  ПОЧЕМУ НУЖНА БЛОКИРОВКА:
  ---------------------------------
  Без блокировки: темно → лампа включилась → свет лампы попал на датчик
  → датчик показывает "свет" → лампа выключилась → снова темно → лампа включилась...
  Получается бесконечное мигание (дребезг).
  
  С блокировкой: лампа включается и НЕ может выключиться 15 секунд,
  этого времени достаточно, чтобы свет лампы перестал влиять на датчик
  (или датчик успел адаптироваться).


  КАК РАБОТАЕТ ФОРТОЧКА:
  ---------------------------------
  - Открывается при температуре > 28°C
  - Закрывается при температуре < 26°C
  - Между 26°C и 28°C положение не меняется (гистерезис)
*/

// =====================================================================
// РАЗДЕЛ 15: ОБНОВЛЕНИЕ ИНФОРМАЦИИ НА ДИСПЛЕЕ (5 ЭКРАНОВ)
// =====================================================================

// Функция для обновления информации на дисплее
void updateDisplay() {
  // Если дисплей не в нормальном режиме - не обновляем
  if (currentDisplayMode != DISPLAY_NORMAL) {
    return;
  }
  
  // Проверяем здоровье дисплея
  if (!checkLCDHealth()) {
    // Если дисплей не отвечает - переходим в режим восстановления
    currentDisplayMode = DISPLAY_RECOVERING;
    return;
  }
  
  // Проверяем, прошло ли 3 секунды с последней смены экрана
  if (millis() - lastDisplayChange > DISPLAY_CHANGE_TIME) {
    // Переключаем экран на следующий (0→1→2→3→4→0...)
    displayScreen = (displayScreen + 1) % MAX_DISPLAY_SCREENS;
    lastDisplayChange = millis();
    
    // Очищаем экран печатью пробелов (более стабильно, чем lcd->clear())
    safePrint("                ", 0, 0);
    safePrint("                ", 0, 1);
  }
  
  // В зависимости от номера экрана показываем разную информацию
  switch(displayScreen) {
    
    case 0:  // ЭКРАН 0: ТЕМПЕРАТУРА И СОСТОЯНИЕ ФОРТОЧКИ
      safePrint("TEMP: ", 0, 0);
      
      if (isnan(tempFiltered)) {
        safePrint("Error", 6, 0);
      } else {
        char tempStr[10];
        dtostrf(tempFiltered, 5, 1, tempStr);  // float в строку
        safePrint(tempStr, 6, 0);
        lcd->write(223);  // Символ градуса ° (ASCII код 223)
        safePrint("C", 12, 0);
      }
      
      if (tempFiltered >= OPEN_TEMP) {
        safePrint("WINDOW: OPEN", 0, 1);
      } else if (tempFiltered <= CLOSE_TEMP) {
        safePrint("WINDOW: CLOSED", 0, 1);
      } else {
        safePrint("WINDOW: OK", 0, 1);
      }
      break;
      
    case 1:  // ЭКРАН 1: ВЛАЖНОСТЬ ВОЗДУХА
      safePrint("AIR HUM: ", 0, 0);
      
      if (isnan(humidityFiltered)) {
        safePrint("Error", 9, 0);
      } else {
        char humStr[10];
        dtostrf(humidityFiltered, 5, 0, humStr);
        safePrint(humStr, 9, 0);
        safePrint("%", 14, 0);
      }
      
      if (humidityFiltered >= 80) {
        safePrint("STATUS: HUMID", 0, 1);
      } else if (humidityFiltered >= 60) {
        safePrint("STATUS: NORMAL", 0, 1);
      } else if (humidityFiltered >= 40) {
        safePrint("STATUS: DRY", 0, 1);
      } else {
        safePrint("STATUS: VERY DRY", 0, 1);
      }
      break;
      
    case 2:  // ЭКРАН 2: ОСВЕЩЁННОСТЬ И ФИТОЛЕНТА
      safePrint("LIGHT: ", 0, 0);
      
      char lightStr[10];
      itoa(lightLevelFiltered, lightStr, 10);
      safePrint(lightStr, 7, 0);
      safePrint("%", 10, 0);
      
      safePrint("GROW LIGHT: ", 0, 1);
      safePrint(lampState ? "ON" : "OFF", 12, 1);
      break;
      
    case 3:  // ЭКРАН 3: ВЛАЖНОСТЬ ПОЧВЫ И НАСОС
      safePrint("SOIL: ", 0, 0);
      
      char soilStr[10];
      itoa(soilMoistureFiltered, soilStr, 10);
      safePrint(soilStr, 6, 0);
      safePrint("%", 9, 0);
      
      safePrint("WATER PUMP: ", 0, 1);
      safePrint(pumpState ? "ON" : "OFF", 12, 1);
      break;
      
    case 4:  // ЭКРАН 4: УРОВЕНЬ ВОДЫ В БАКЕ
      safePrint("WATER: ", 0, 0);
      
      if (waterPresent) {
        safePrint("FULL", 7, 0);
      } else {
        safePrint("EMPTY", 7, 0);
      }
      
      safePrint("                ", 0, 1);
      
      if (!waterPresent) {
        safePrint("REFILL WATER!", 0, 1);
      } else if (soilMoistureFiltered < SOIL_DRY) {
        safePrint("READY TO WATER", 0, 1);
      } else {
        safePrint("SYSTEM OK", 0, 1);
      }
      break;
  }
  
  // Обновляем время последней успешной работы дисплея
  lastDisplaySuccess = millis();
}


// =====================================================================
// РАЗДЕЛ 16: ОТЛАДОЧНЫЙ ВЫВОД В СЕРИАЛЬНЫЙ МОНИТОР
// =====================================================================

// Функция для отладочного вывода в Serial монитор
void debugOutput() {
  // Статическая переменная для хранения времени последнего вывода
  static unsigned long lastDebug = 0;
  
  // Проверяем, прошло ли 5 секунд (5000 мс)
  if (millis() - lastDebug > 5000) {
    lastDebug = millis();
    
    Serial.println("\n=== GREENHOUSE STATUS REPORT ===");
    Serial.print("Temperature: "); Serial.print(tempFiltered); Serial.println(" °C");
    Serial.print("Air humidity: "); Serial.print(humidityFiltered); Serial.println(" %");
    Serial.print("Light level: "); Serial.print(lightLevelFiltered); Serial.println(" %");
    Serial.print("Soil moisture: "); Serial.print(soilMoistureFiltered); Serial.println(" %");
    Serial.print("Water tank: "); Serial.println(waterPresent ? "FULL" : "EMPTY");
    
    Serial.print("Devices: ");
    Serial.print("Grow light "); Serial.print(lampState ? "ON" : "OFF");
    Serial.print(", Water pump "); Serial.print(pumpState ? "ON" : "OFF");
    Serial.print(", Window "); Serial.println(windowIsOpen ? "OPEN" : "CLOSED");
    
    Serial.print("Relay logic: ");
    Serial.println(RELAY_INVERTED ? "INVERTED (LOW=ON)" : "NORMAL (HIGH=ON)");
    
    Serial.print("Display mode: ");
    if (currentDisplayMode == DISPLAY_NORMAL) {
      Serial.print("NORMAL, ");
      Serial.print(displayRecoveryAttempts);
      Serial.println(" recovery attempts");
    } else if (currentDisplayMode == DISPLAY_RECOVERING) {
      Serial.println("RECOVERING");
    } else {
      Serial.println("DISCONNECTED");
    }
    
    Serial.println("==================================\n");
  }
}


// =====================================================================
// РАЗДЕЛ 18: ГЛАВНЫЙ ЦИКЛ ПРОГРАММЫ (LOOP) - ИСПРАВЛЕННАЯ ВЕРСИЯ
// =====================================================================
// loop() — это бесконечный цикл, который выполняется после setup()
// Внутри loop() происходит вся основная логика работы теплицы
// =====================================================================

void loop() {
  
  // -------------------------------------------------------------------
  // БЛОК 0: ИНДИКАЦИЯ ЖИЗНЕСПОСОБНОСТИ (мигание светодиодом)
  // -------------------------------------------------------------------
  // Это помогает понять, жив ли Arduino или завис.
  // Светодиод на пине 13 мигает раз в секунду — если мигание прекратилось,
  // значит программа зависла и watchdog скоро перезагрузит систему.
  // static unsigned long lastBlink — переменная хранит время последнего мигания
  // static означает, что переменная сохраняет своё значение между вызовами loop()
  static unsigned long lastBlink = 0;
  static bool ledState = false;   // Текущее состояние светодиода (вкл/выкл)
  
  // Если прошла 1 секунда (1000 мс) с последнего мигания
  if (millis() - lastBlink > 1000) {
    lastBlink = millis();           // Обновляем время последнего мигания
    ledState = !ledState;           // Переключаем состояние (вкл→выкл, выкл→вкл)
    digitalWrite(STATUS_LED, ledState);  // Устанавливаем новое состояние
    Serial.println("I'm alive!");   // Выводим сообщение в монитор порта
  }

  // -------------------------------------------------------------------
  // БЛОК 1: СБРОС WATCHDOG (САМОЕ ПЕРВОЕ ДЕЙСТВИЕ В ЦИКЛЕ!)
  // -------------------------------------------------------------------
  // Watchdog — это аппаратный таймер, который перезагружает Arduino, если
  // программа зависла. Его нужно регулярно сбрасывать, иначе он сработает.
  // 
  // ПОЧЕМУ В САМОМ НАЧАЛЕ? 
  // Если какие-то операции в конце предыдущего цикла заняли много времени,
  // мы всё равно сбросим watchdog в начале следующего цикла.
  // Также если программа зависнет где-то в середине loop(), то до этого места
  // мы уже дошли, значит watchdog сброшен и перезагрузки не будет на этом цикле.
  // 
  // wdt_reset() — сбрасывает таймер watchdog
  // Если этот вызов не произойдёт в течение 2 секунд (WDTO_2S), Arduino перезагрузится
  wdt_reset();
  
  
  // -------------------------------------------------------------------
  // БЛОК 2: УПРАВЛЕНИЕ СОСТОЯНИЕМ ДИСПЛЕЯ (ИСПРАВЛЕННАЯ ВЕРСИЯ)
  // -------------------------------------------------------------------
  // Раньше здесь была ошибка: проверка здоровья и попытки восстановления
  // вызывались КАЖДЫЙ цикл (каждые ~100 мс), что создавало нагрузку на шину I2C
  // и могло вызывать зависание дисплея.
  // 
  // Теперь мы используем ТАЙМЕРЫ:
  // - Попытки восстановления не чаще 1 раза в 5 секунд
  // - Проверка здоровья не чаще 1 раза в 10 секунд
  // -------------------------------------------------------------------
  
  // Статическая переменная для хранения времени последней попытки восстановления
  // static — сохраняет значение между вызовами loop()
  static unsigned long lastRecoveryAttempt = 0;
  
  // ПРОВЕРКА: дисплей в нормальном режиме или нет?
  if (currentDisplayMode != DISPLAY_NORMAL) {
    // ДИСПЛЕЙ НЕ В НОРМАЛЬНОМ РЕЖИМЕ — пытаемся восстановить
    
    // ВАЖНО: не пытаемся восстанавливать слишком часто!
    // Если прошло меньше 5 секунд с последней попытки — пропускаем
    if (millis() - lastRecoveryAttempt > 5000) {
      lastRecoveryAttempt = millis();  // Запоминаем время этой попытки
      
      // Пытаемся восстановить дисплей (функция из раздела 9)
      // attemptDisplayRecovery() возвращает true, если удалось восстановить
      if (!attemptDisplayRecovery()) {
        // Если восстановление не удалось — выводим сообщение и ждём следующей попытки
        // Дисплей продолжает работать в режиме DISPLAY_RECOVERING
        Serial.println("Display recovery failed, will retry later");
      }
    }
  } else {
    // ДИСПЛЕЙ В НОРМАЛЬНОМ РЕЖИМЕ — проверяем его здоровье
    
    // Статическая переменная для хранения времени последней проверки здоровья
    static unsigned long lastHealthCheck = 0;
    
    // Проверяем здоровье НЕ чаще 1 раза в 10 секунд
    // Это уменьшает нагрузку на шину I2C и предотвращает конфликты
    if (millis() - lastHealthCheck > 10000) {
      lastHealthCheck = millis();  // Запоминаем время этой проверки
      
      // checkLCDHealth() возвращает true, если дисплей отвечает на команды
      if (!checkLCDHealth()) {
        // Если дисплей не отвечает — переходим в режим восстановления
        // В следующем цикле attemptDisplayRecovery() попытается его починить
        Serial.println("Display health check failed, entering recovery mode");
        currentDisplayMode = DISPLAY_RECOVERING;
      }
    }
  }
  
  // Сбрасываем watchdog после блока управления дисплеем
  // Если этот блок зависнет (например, из-за ошибки в коде), watchdog перезагрузит Arduino
  wdt_reset();
  
  
  // -------------------------------------------------------------------
  // БЛОК 3: ЧТЕНИЕ ВСЕХ ДАТЧИКОВ
  // -------------------------------------------------------------------
  // Опрашиваем все датчики с помощью функции readSensors()
  // Эта функция обновляет глобальные переменные:
  // - tempFiltered (температура воздуха в градусах Цельсия)
  // - humidityFiltered (влажность воздуха в процентах)
  // - soilMoistureFiltered (влажность почвы в процентах)
  // - lightLevelFiltered (освещённость в процентах)
  // - waterPresent (наличие воды в баке, true/false, если датчик включён)
  readSensors();
  
  // Сбрасываем watchdog после чтения датчиков
  // Если какой-то датчик (например, DHT11) зависнет, watchdog перезагрузит Arduino
  wdt_reset();
  
  
  // -------------------------------------------------------------------
  // БЛОК 4: УПРАВЛЕНИЕ ВСЕМИ СИСТЕМАМИ ТЕПЛИЦЫ
  // -------------------------------------------------------------------
  // Управляем устройствами (полив, свет, вентиляция) с помощью функции controlSystems()
  // Эта функция принимает решения:
  // - Включить или выключить насос (полив) — по датчику влажности почвы
  // - Включить или выключить фитоленту (освещение) — по датчику освещённости
  // - Открыть или закрыть форточку (вентиляция) — через вызов controlWindow()
  controlSystems();
  
  // Сбрасываем watchdog после управления устройствами
  wdt_reset();
  
  
  // -------------------------------------------------------------------
  // БЛОК 5: ОБНОВЛЕНИЕ ИНФОРМАЦИИ НА ДИСПЛЕЕ
  // -------------------------------------------------------------------
  // Выводим данные на LCD дисплей с помощью функции updateDisplay()
  // Функция показывает 5 экранов по очереди:
  // - Экран 0: температура и состояние форточки
  // - Экран 1: влажность воздуха и её статус
  // - Экран 2: освещённость и состояние фитоленты
  // - Экран 3: влажность почвы и состояние насоса
  // - Экран 4: уровень воды в баке
  updateDisplay();
  
  // Сбрасываем watchdog после обновления дисплея
  // Если дисплей завис, updateDisplay() может зависнуть, но watchdog перезагрузит Arduino
  wdt_reset();
  
  
  // -------------------------------------------------------------------
  // БЛОК 6: ОТЛАДОЧНЫЙ ВЫВОД В СЕРИАЛЬНЫЙ МОНИТОР
  // -------------------------------------------------------------------
  // Выводим статус системы в Serial монитор с помощью функции debugOutput()
  // Эта функция выводит все показания датчиков и состояния устройств
  // раз в 5 секунд (чтобы не засорять монитор порта).
  // Это полезно для отладки и диагностики проблем.
  debugOutput();
  
  // =====================================================================
  // ДИАГНОСТИКА ДАТЧИКА ВОДЫ (ВЫВОД В SERIAL МОНИТОР)
  // =====================================================================
  #if ENABLE_WATER
  static unsigned long lastDiagnostic = 0;
  if (millis() - lastDiagnostic > 2000) {  // Каждые 2 секунды
    lastDiagnostic = millis();
    
    // 1. Включаем питание датчика
    digitalWrite(WATER_SENSOR_RELAY_PIN, LOW);
    delay(50);
    
    // 2. Читаем сигнал 10 раз подряд (быстро)
    int readings[10];
    for (int i = 0; i < 10; i++) {
        readings[i] = digitalRead(WATER_SENSOR_PIN);
        delay(2);
    }
    
    // 3. Выключаем питание
    digitalWrite(WATER_SENSOR_RELAY_PIN, HIGH);
    
    // 4. Анализируем результаты
    int highCount = 0;
    int lowCount = 0;
    int changes = 0;
    
    for (int i = 0; i < 10; i++) {
        if (readings[i] == HIGH) highCount++;
        else lowCount++;
        
        if (i > 0 && readings[i] != readings[i-1]) {
            changes++;
        }
    }
    
    // 5. Выводим подробный отчет
    Serial.println("========================================");
    Serial.print("RAW READINGS (10 samples): ");
    for (int i = 0; i < 10; i++) {
        Serial.print(readings[i] ? "H" : "L");
        if (i < 9) Serial.print("-");
    }
    Serial.println();
    
    Serial.print("HIGH count: "); Serial.print(highCount);
    Serial.print("  LOW count: "); Serial.print(lowCount);
    Serial.print("  Changes: "); Serial.println(changes);
    
    // 6. ДИАГНОЗ
    if (changes > 5) {
        Serial.println("!!! PROBLEM: Rapid toggling (MULTIPLE changes per second)");
        Serial.println("    This indicates: electrical noise or bad connection");
    } else if (changes >= 2 && changes <= 5) {
        Serial.println("!!! PROBLEM: Frequent changes (bouncing)");
        Serial.println("    This indicates: water surface agitation or unstable sensor");
    } else if (highCount > 0 && highCount < 10 && changes == 0) {
        Serial.println("!!! PROBLEM: Mixed readings but stable");
        Serial.println("    This indicates: sensor partially submerged or oxidation");
    } else if (highCount == 10) {
        Serial.println("OK: Sensor STABLE in WATER (FULL)");
    } else if (lowCount == 10) {
        Serial.println("OK: Sensor STABLE in AIR (EMPTY)");
    }
    
    // 7. Текущее состояние
    Serial.print("Current waterPresent = ");
    Serial.println(waterPresent ? "FULL" : "EMPTY");
    Serial.println("========================================");
  }
  #endif

  // Сбрасываем watchdog после отладки
  wdt_reset();
  
  
  // -------------------------------------------------------------------
  // БЛОК 7: АВТОМАТИЧЕСКИЙ СБРОС ДИСПЛЕЯ (если включена супер-защита)
  // -------------------------------------------------------------------
  // Эта секция работает только если определён макрос SUPER_PROTECTION = true
  // Она отслеживает, когда дисплей перестал обновляться, и пытается его перезапустить.
  #if SUPER_PROTECTION
  
  // static unsigned long lastAutoResetCheck — статическая переменная
  // static означает, что переменная сохраняет своё значение между вызовами loop()
  // Хранит время последней автоматической проверки дисплея
  static unsigned long lastAutoResetCheck = millis();
  
  // Проверяем, прошло ли 30 секунд (30000 мс) с последней проверки
  if (millis() - lastAutoResetCheck > 30000) {
    // Обновляем время последней проверки
    lastAutoResetCheck = millis();
    
    // Проверяем, не обновлялся ли дисплей последние 25 секунд
    // lastDisplaySuccess — время последней успешной операции с дисплеем
    // (обновляется при каждой успешной печати или очистке экрана)
    if (millis() - lastDisplaySuccess > 25000) {
      // Если дисплей не обновлялся 25+ секунд — считаем его зависшим
      Serial.println("Auto-reset: Display not updated for 25+ seconds");
      
      // МЯГКИЙ СБРОС ДИСПЛЕЯ:
      // Выключаем и включаем подсветку — это часто помогает "разбудить" дисплей
      if (lcd != NULL) {
        lcd->noBacklight();   // Выключаем подсветку
        delay(100);           // Ждём 100 мс
        lcd->backlight();     // Включаем подсветку обратно
        delay(100);           // Ждём 100 мс
      }
      
      // Переходим в режим восстановления
      // В следующем цикле attemptDisplayRecovery() попытается переинициализировать дисплей
      currentDisplayMode = DISPLAY_RECOVERING;
      
      // Сбрасываем счётчик попыток восстановления (начинаем с нуля)
      displayRecoveryAttempts = 0;
    }
  }
  #endif  // Конец #if SUPER_PROTECTION
  
  // Сбрасываем watchdog после блока авто-сброса дисплея
  wdt_reset();
  
  
  // -------------------------------------------------------------------
  // БЛОК 8: ПАУЗА ДЛЯ СТАБИЛЬНОЙ РАБОТЫ
  // -------------------------------------------------------------------
  // Ждем 100 миллисекунд (0.1 секунды) перед следующим циклом
  // Пауза нужна для:
  // 1. Стабильности работы системы — устройствам нужно время на реакцию
  // 2. Предотвращения перегрузки процессора — Arduino не успевает "отдыхать"
  // 3. Датчикам нужно время между измерениями (особенно DHT11)
  // 4. Снижения энергопотребления
  // 5. Возможности отслеживать работу через Serial монитор (не слишком быстро)
  delay(100);
  
  // -------------------------------------------------------------------
  // БЛОК 9: ПОСЛЕДНИЙ СБРОС WATCHDOG (перед выходом из цикла)
  // -------------------------------------------------------------------
  // Если delay(100) почему-то зависнет (например, из-за проблем с таймером),
  // watchdog сработает через 2 секунды и перезагрузит Arduino.
  // Этот вызов гарантирует, что даже если delay() отработал нормально,
  // мы сбросим watchdog перед следующим проходом цикла.
  wdt_reset();
  
} // КОНЕЦ ФУНКЦИИ loop()


// =====================================================================
// ПОЯСНЕНИЕ РАБОТЫ WATCHDOG (для понимания комиссии)
// =====================================================================
/*
  ЧТО ТАКОЕ WATCHDOG?
  
  Watchdog (сторожевой таймер) — это аппаратный таймер, встроенный в микроконтроллер.
  Он работает независимо от программы и считает время.
  
  КАК ЭТО РАБОТАЕТ?
  
  1. В setup() мы включаем watchdog: wdt_enable(WDTO_2S)
     Это означает: "если я не получу сигнал 'я жив' в течение 2 секунд, перезагрузи меня"
  
  2. В loop() мы регулярно вызываем wdt_reset()
     Это сигнал "я жив, всё работает, не перезагружай меня"
  
  3. Если программа зависла (бесконечный цикл, зависание I2C, ошибка в коде):
     - wdt_reset() перестаёт вызываться
     - watchdog продолжает считать время
     - Через 2 секунды watchdog истекает и перезагружает микроконтроллер
  
  4. После перезагрузки:
     - Arduino начинает работу заново с функции setup()
     - Дисплей переинициализируется
     - Все датчики опрашиваются заново
     - Система продолжает работать
  
  ПОЧЕМУ ЭТО ВАЖНО ДЛЯ ТЕПЛИЦЫ?
  
  - Если теплица зависнет ночью, растения могут погибнуть без полива
  - Watchdog автоматически "лечит" систему без участия человека
  - Это профессиональное решение, используемое в промышленной автоматике
  
  КАК ВЫБРАТЬ ВРЕМЯ?
  
  - WDTO_2S (2 секунды) — оптимально для Arduino
  - Слишком маленькое время (WDTO_250MS) — может вызывать ложные перезагрузки
  - Слишком большое время (WDTO_8S) — система будет долго "висеть" перед перезагрузкой
*/


// =====================================================================
// КОНЕЦ ПРОГРАММЫ
// =====================================================================
```
